## silicon_id/Kconfig
```kconfig
# Copyright 2024 NXP
# SPDX-License-Identifier: BSD-3-Clause

rsource "Kconfig.chip"

config MCUX_COMPONENT_component.silicon_id
    bool "silicon_id"
    select MCUX_COMPONENT_driver.common

    select MCUX_COMPONENT_component.silicon_id_imxrt10xx if MCUX_DEPENDENCY_COMPONENT_SILICON_ID_RT10XX
    select MCUX_COMPONENT_component.silicon_id_imxrt1170 if MCUX_DEPENDENCY_COMPONENT_SILICON_ID_RT1170
    select MCUX_COMPONENT_component.silicon_id_imxrt1180 if MCUX_DEPENDENCY_COMPONENT_SILICON_ID_RT1180
    select MCUX_COMPONENT_component.silicon_id_imx8 if MCUX_DEPENDENCY_COMPONENT_SILICON_ID_IMX8
    select MCUX_COMPONENT_component.silicon_id_imx93 if MCUX_DEPENDENCY_COMPONENT_SILICON_ID_IMX93
    select MCUX_COMPONENT_component.silicon_id_scfw if MCUX_DEPENDENCY_COMPONENT_SILICON_ID_SCFW
    select MCUX_COMPONENT_component.silicon_id_rw610 if MCUX_DEPENDENCY_COMPONENT_SILICON_ID_RW610

    select MCUX_COMPONENT_driver.sim if MCUX_DEPENDENCY_COMPONENT_SILICON_ID_SIM
    select MCUX_COMPONENT_driver.iap if MCUX_DEPENDENCY_COMPONENT_SILICON_ID_IAP
    select MCUX_COMPONENT_driver.flashiap if MCUX_DEPENDENCY_COMPONENT_SILICON_ID_FLASHIAP
    select MCUX_COMPONENT_driver.romapi_flashiap if MCUX_DEPENDENCY_COMPONENT_SILICON_ID_ROMAPI_FLASHIAP

config MCUX_COMPONENT_component.silicon_id_imxrt10xx
    bool
    depends on MCUX_DEPENDENCY_COMPONENT_SILICON_ID_RT10XX

config MCUX_COMPONENT_component.silicon_id_imxrt1170
    bool
    depends on MCUX_DEPENDENCY_COMPONENT_SILICON_ID_RT1170

config MCUX_COMPONENT_component.silicon_id_imxrt1180
    bool
    depends on MCUX_DEPENDENCY_COMPONENT_SILICON_ID_RT1180

config MCUX_COMPONENT_component.silicon_id_imx8
    bool
    depends on MCUX_DEPENDENCY_COMPONENT_SILICON_ID_IMX8

config MCUX_COMPONENT_component.silicon_id_imx93
    bool
    depends on MCUX_DEPENDENCY_COMPONENT_SILICON_ID_IMX93

config MCUX_COMPONENT_component.silicon_id_scfw
    bool
    depends on MCUX_DEPENDENCY_COMPONENT_SILICON_ID_SCFW

config MCUX_COMPONENT_component.silicon_id_rw610
    bool
    depends on MCUX_DEPENDENCY_COMPONENT_SILICON_ID_RW610
```

## silicon_id/Kconfig.chip
```kconfig
# Copyright 2024-2025 NXP
# SPDX-License-Identifier: BSD-3-Clause

config MCUX_DEPENDENCY_COMPONENT_SILICON_ID_RT10XX
    bool
    default y
    depends on (MCUX_HW_DEVICE_ID_MIMXRT1011xxxxx || MCUX_HW_DEVICE_ID_MIMXRT1015xxxxx ||\
                MCUX_HW_DEVICE_ID_MIMXRT1021xxxxx || MCUX_HW_DEVICE_ID_MIMXRT1024xxxxx ||\
                MCUX_HW_DEVICE_ID_MIMXRT1041xxxxB || MCUX_HW_DEVICE_ID_MIMXRT1042xxxxB ||\
                MCUX_HW_DEVICE_ID_MIMXRT1051xxxxB || MCUX_HW_DEVICE_ID_MIMXRT1052xxxxB ||\
                MCUX_HW_DEVICE_ID_MIMXRT1062xxxxA || MCUX_HW_DEVICE_ID_MIMXRT1062xxxxB ||\
                MCUX_HW_DEVICE_ID_MIMXRT1064xxxxA || MCUX_HW_DEVICE_ID_MIMXRT1064xxxxB ||\
                MCUX_HW_DEVICE_ID_MIMXRT1071xxxxA || MCUX_HW_DEVICE_ID_MIMXRT1072xxxxB)

config MCUX_DEPENDENCY_COMPONENT_SILICON_ID_RT1170
    bool
    default y
    depends on (MCUX_HW_DEVICE_ID_MIMXRT1165xxxxx || MCUX_HW_DEVICE_ID_MIMXRT1166xxxxx ||\
                MCUX_HW_DEVICE_ID_MIMXRT1171xxxxx || MCUX_HW_DEVICE_ID_MIMXRT1172xxxxx ||\
                MCUX_HW_DEVICE_ID_MIMXRT1173xxxxx || MCUX_HW_DEVICE_ID_MIMXRT1175xxxxx ||\
                MCUX_HW_DEVICE_ID_MIMXRT1176xxxxx)

config MCUX_DEPENDENCY_COMPONENT_SILICON_ID_RT1180
    bool
    default y
    depends on (MCUX_HW_DEVICE_ID_MIMXRT1181xxxxx || MCUX_HW_DEVICE_ID_MIMXRT1182xxxxx ||\
                MCUX_HW_DEVICE_ID_MIMXRT1186xxxxx || MCUX_HW_DEVICE_ID_MIMXRT1187xxxxx || \
                MCUX_HW_DEVICE_ID_MIMXRT1189xxxxx)

config MCUX_DEPENDENCY_COMPONENT_SILICON_ID_IMX8
    bool
    default y
    depends on (MCUX_HW_DEVICE_ID_MIMX8ML3xxxLZ || MCUX_HW_DEVICE_ID_MIMX8ML3xxxKZ ||\
                MCUX_HW_DEVICE_ID_MIMX8ML4xxxLZ || MCUX_HW_DEVICE_ID_MIMX8ML4xxxKZ ||\
                MCUX_HW_DEVICE_ID_MIMX8ML6xxxLZ || MCUX_HW_DEVICE_ID_MIMX8ML6xxxKZ ||\
                MCUX_HW_DEVICE_ID_MIMX8ML8xxxLZ || MCUX_HW_DEVICE_ID_MIMX8ML8xxxKZ ||\
                MCUX_HW_DEVICE_ID_MIMX8MM1xxxLZ || MCUX_HW_DEVICE_ID_MIMX8MM1xxxLZ ||\
                MCUX_HW_DEVICE_ID_MIMX8MM2xxxLZ || MCUX_HW_DEVICE_ID_MIMX8MM2xxxLZ ||\
                MCUX_HW_DEVICE_ID_MIMX8MM3xxxLZ || MCUX_HW_DEVICE_ID_MIMX8MM3xxxLZ ||\
                MCUX_HW_DEVICE_ID_MIMX8MM4xxxLZ || MCUX_HW_DEVICE_ID_MIMX8MM4xxxLZ ||\
                MCUX_HW_DEVICE_ID_MIMX8MM5xxxLZ || MCUX_HW_DEVICE_ID_MIMX8MM5xxxLZ ||\
                MCUX_HW_DEVICE_ID_MIMX8MM6xxxLZ || MCUX_HW_DEVICE_ID_MIMX8MM6xxxLZ)

config MCUX_DEPENDENCY_COMPONENT_SILICON_ID_IMX93
    bool
    default y
    depends on (MCUX_HW_DEVICE_ID_MIMX9301xxxxD || MCUX_HW_DEVICE_ID_MIMX9302xxxxD ||\
                MCUX_HW_DEVICE_ID_MIMX9311xxxxM || MCUX_HW_DEVICE_ID_MIMX9312xxxxM ||\
                MCUX_HW_DEVICE_ID_MIMX9321xxxxM || MCUX_HW_DEVICE_ID_MIMX9322xxxxM ||\
                MCUX_HW_DEVICE_ID_MIMX9331xxxxM || MCUX_HW_DEVICE_ID_MIMX9332xxxxM ||\
                MCUX_HW_DEVICE_ID_MIMX9351xxxxM || MCUX_HW_DEVICE_ID_MIMX9352xxxxM)

config MCUX_DEPENDENCY_COMPONENT_SILICON_ID_SCFW
    bool
    default y
    depends on (MCUX_HW_DEVICE_ID_MIMX8QM5xxxFF || MCUX_HW_DEVICE_ID_MIMX8QM6xxxFF ||\
                MCUX_HW_DEVICE_ID_MIMX8QX1xxxDZ || MCUX_HW_DEVICE_ID_MIMX8QX1xxxDZ ||\
                MCUX_HW_DEVICE_ID_MIMX8QX2xxxDZ || MCUX_HW_DEVICE_ID_MIMX8QX2xxxDZ ||\
                MCUX_HW_DEVICE_ID_MIMX8QX3xxxDZ || MCUX_HW_DEVICE_ID_MIMX8QX3xxxDZ ||\
                MCUX_HW_DEVICE_ID_MIMX8QX4xxxDZ || MCUX_HW_DEVICE_ID_MIMX8QX4xxxDZ ||\
                MCUX_HW_DEVICE_ID_MIMX8QX5xxxDZ || MCUX_HW_DEVICE_ID_MIMX8QX5xxxDZ ||\
                MCUX_HW_DEVICE_ID_MIMX8QX6xxxDZ || MCUX_HW_DEVICE_ID_MIMX8QX6xxxDZ)

config MCUX_DEPENDENCY_COMPONENT_SILICON_ID_RW610
    bool
    default y
    depends on (MCUX_HW_DEVICE_ID_RW610 || MCUX_HW_DEVICE_RW612) # FIXME: Update

config MCUX_DEPENDENCY_COMPONENT_SILICON_ID_SIM
    bool
    default y
    depends on MCUX_HW_IP_DriverType_SIM

config MCUX_DEPENDENCY_COMPONENT_SILICON_ID_IAP
    bool
    default y
    depends on MCUX_HW_IP_DriverType_IAP

config MCUX_DEPENDENCY_COMPONENT_SILICON_ID_FLASHIAP
    bool
    default y
    depends on MCUX_HW_IP_DriverType_FLASHIAP

config MCUX_DEPENDENCY_COMPONENT_SILICON_ID_MCXN
    bool
    default y
    depends on MCUX_HW_DEVICE_MCXN235 || MCUX_HW_DEVICE_MCXN236 ||\
               MCUX_HW_DEVICE_ID_MCXN546 || MCUX_HW_DEVICE_ID_MCXN547 ||\
               MCUX_HW_DEVICE_ID_MCXN946 || MCUX_HW_DEVICE_ID_MCXN947
```
