## mt48lc2m32b2/Kconfig
```kconfig
# Copyright 2024 NXP
# SPDX-License-Identifier: BSD-3-Clause

config MCUX_COMPONENT_driver.mt48lc2m32b2
    bool "Component driver.mt48lc2m32b2"
    select MCUX_COMPONENT_driver.sdramc
    
```

## mt48lc4m16a2/Kconfig
```kconfig
# Copyright 2024 NXP
# SPDX-License-Identifier: BSD-3-Clause

config MCUX_COMPONENT_driver.mt48lc4m16a2
    bool "mt48lc4m16a2"
    select MCUX_COMPONENT_driver.sdramc
```

## mx25l_flash/Kconfig
```kconfig
# Copyright 2024 NXP
# SPDX-License-Identifier: BSD-3-Clause

config MCUX_COMPONENT_driver.mx25l_flash
    bool "mx25l_flash"
```

## mx25r_flash/Kconfig
```kconfig
# Copyright 2024 NXP
# SPDX-License-Identifier: BSD-3-Clause

config MCUX_COMPONENT_driver.mx25r_flash
    bool "mx25r_flash"
```

## osa/Kconfig
```kconfig
# Copyright 2024-2025 NXP
# SPDX-License-Identifier: BSD-3-Clause

config MCUX_COMPONENT_component.osa_template_config
    bool "OSA template configuration header file"
    default n
    help
        Not generate fsl_os_abstraction_config.h, users need use default template fsl_os_abstraction_config.h.

config MCUX_COMPONENT_component.osa
    bool "OSA"
    select MCUX_COMPONENT_driver.common
    select MCUX_COMPONENT_component.lists
    select MCUX_COMPONENT_component.osa_template_config
    help
        Enable component.osa component

    if MCUX_COMPONENT_component.osa
        choice MCUX_COMPONENT_component.osa.selection
            prompt "OSA selection"
            config MCUX_COMPONENT_component.osa_bm
                bool "bm"
                depends on !MCUX_COMPONENT_middleware.freertos-kernel
                depends on !MCUX_COMPONENT_middleware.azure_rtos.tx
                depends on !MCUX_COMPONENT_middleware.zephyr
            config MCUX_COMPONENT_component.osa_free_rtos
                bool "freertos"
                depends on MCUX_COMPONENT_middleware.freertos-kernel
            config MCUX_COMPONENT_component.osa_threadx
                bool "threadx"
                depends on MCUX_COMPONENT_middleware.wireless.ble_controller_threadx
            config MCUX_COMPONENT_component.osa_zephyr
                bool "zephyr"
                depends on MCUX_COMPONENT_middleware.zephyr
        endchoice
    endif

config MCUX_PRJSEG_component.osa_interface.generated_config
    bool "Generate OSA configuration header"
    default y
    depends on MCUX_COMPONENT_component.osa
    help
        Generate the fsl_os_abstraction_config.h, otherwise users need to provide their
        own fsl_os_abstraction_config.h.

if MCUX_PRJSEG_component.osa_interface.generated_config
    menu "Configuration (fsl_os_abstraction_config.h)"
        config gMainThreadStackSize_c
            int "gMainThreadStackSize_c"
            default 1024
            help
                No prefix in generated macro

        config gMainThreadPriority_c
            int "gMainThreadPriority_c"
            default 7
            help
                No prefix in generated macro

        config gTaskMultipleInstancesManagement_c
            int "gTaskMultipleInstancesManagement_c"
            default 0
            help
                No prefix in generated macro

        config FSL_OSA_TASK_ENABLE
            bool "FSL_OSA_TASK_ENABLE"
            default y
            help
                No prefix in generated macro

        config FSL_OSA_MAIN_FUNC_ENABLE
            bool "FSL_OSA_MAIN_FUNC_ENABLE"
            default n
            help
                No prefix in generated macro

        config FSL_OSA_BM_TIMEOUT_ENABLE
            bool "FSL_OSA_BM_TIMEOUT_ENABLE"
            default n
            help
                No prefix in generated macro

        config FSL_OSA_ALLOCATED_HEAP
            bool "FSL_OSA_ALLOCATED_HEAP"
            default y
            help
                No prefix in generated macro
    endmenu
endif

config MCUX_PRJSEG_component.osa_interface.osa_macro_used
    bool "OSA USED"
    default y
    depends on MCUX_COMPONENT_component.osa
    help
        Add OSA_USED macro for component osa.
```

## phy/Kconfig
```kconfig
# Copyright 2024-2025 NXP
# SPDX-License-Identifier: BSD-3-Clause

config MCUX_COMPONENT_component.eth_phy_common
    bool
    select MCUX_COMPONENT_driver.common

config MCUX_COMPONENT_component.phyrtl8211f
    bool "rtl8211f"
    select MCUX_COMPONENT_component.eth_phy_common

config MCUX_COMPONENT_component.phyaqr113c
    bool "aqr113c"
    select MCUX_COMPONENT_component.eth_phy_common

config MCUX_COMPONENT_component.phyksz8081
    bool "ksz8081"
    select MCUX_COMPONENT_component.eth_phy_common

config MCUX_COMPONENT_component.phydp8384x
    bool "dp8384x"
    select MCUX_COMPONENT_component.eth_phy_common

config MCUX_COMPONENT_component.phygpy215
    bool "gpy215"
    select MCUX_COMPONENT_component.eth_phy_common

config MCUX_COMPONENT_component.phyksz8041
    bool "ksz8041"
    select MCUX_COMPONENT_component.eth_phy_common

config MCUX_COMPONENT_component.phyar8031
    bool "ar8031"
    select MCUX_COMPONENT_component.eth_phy_common

config MCUX_COMPONENT_component.phylan8720a
    bool "lan8720a"
    select MCUX_COMPONENT_component.eth_phy_common

config MCUX_COMPONENT_component.phyvsc8541
    bool "vsc8541"
    select MCUX_COMPONENT_component.eth_phy_common

config MCUX_COMPONENT_component.phyrtl8201
    bool "rtl8201"
    select MCUX_COMPONENT_component.eth_phy_common

config MCUX_COMPONENT_component.phylan8741
    bool "lan8741"
    select MCUX_COMPONENT_component.eth_phy_common

config MCUX_COMPONENT_component.phytja1100
    bool "tja1100"
    select MCUX_COMPONENT_component.eth_phy_common

config MCUX_COMPONENT_component.phytja1120
    bool "tja1120"
    select MCUX_COMPONENT_component.eth_phy_common
```

## pinctrl/Kconfig
```kconfig
# Copyright 2024-2025 NXP
#
# SPDX-License-Identifier: BSD-3-Clause

config MCUX_COMPONENT_component.hal_pinctrl
    bool "hal pinctrl"
    select MCUX_COMPONENT_driver.iomuxc
    select MCUX_COMPONENT_component.sm_pinctrl

    if MCUX_COMPONENT_component.hal_pinctrl
      choice
        prompt "Component component.hal_pinctrl anyOf 1"
        default MCUX_DEPENDENCY_COMPONENT_component.hal_pinctrl_DEPEND_ANYOF_OPTION_1

        config MCUX_DEPENDENCY_COMPONENT_component.hal_pinctrl_DEPEND_ANYOF_OPTION_1
          bool "imx95"
          select MCUX_COMPONENT_component.hal_pinctrl.imx95

        config MCUX_DEPENDENCY_COMPONENT_component.hal_pinctrl_DEPEND_ANYOF_OPTION_2
          bool "imx943"
          select MCUX_COMPONENT_component.hal_pinctrl.imx943

      endchoice
    endif

config MCUX_COMPONENT_component.hal_pinctrl.imx943
    bool
    depends on MCUX_HW_BOARD_imx943evk

config MCUX_COMPONENT_component.hal_pinctrl.imx95
    bool
    depends on MCUX_HW_BOARD_imx95lpd5evk19 || MCUX_HW_BOARD_imx95lp4xevk15 || MCUX_HW_BOARD_imx95verdinevk
```

## pmic/Kconfig
```kconfig
# Copyright 2024 NXP
# SPDX-License-Identifier: BSD-3-Clause

config MCUX_DEPENDENCY_COMPONENT_component.use_i2c_dependency_options
    bool "Use i2c target interface to communicate with the host system"
    select MCUX_COMPONENT_driver.flexcomm_i2c if MCUX_HAS_COMPONENT_driver.flexcomm_i2c
    select MCUX_COMPONENT_driver.i2c if MCUX_HAS_COMPONENT_driver.i2c
    select MCUX_COMPONENT_driver.ii2c if MCUX_HAS_COMPONENT_driver.ii2c
    select MCUX_COMPONENT_driver.lpc_i2c if MCUX_HAS_COMPONENT_driver.lpc_i2c
    select MCUX_COMPONENT_driver.lpc_i2c_1 if MCUX_HAS_COMPONENT_driver.lpc_i2c_1
    select MCUX_COMPONENT_driver.lpi2c if MCUX_HAS_COMPONENT_driver.lpi2c
    select MCUX_COMPONENT_driver.lpflexcomm_lpi2c if MCUX_HAS_COMPONENT_driver.lpflexcomm_lpi2c

menu "Pmic driver"

config MCUX_COMPONENT_driver.pca9420
    bool "pca9420"
    select MCUX_COMPONENT_driver.power
    select MCUX_COMPONENT_driver.common
    select MCUX_DEPENDENCY_COMPONENT_component.use_i2c_dependency_options
    help
      Say yes here to select pca9420 driver.

config MCUX_COMPONENT_driver.pca9422
    bool "pca9422"
    select MCUX_COMPONENT_driver.power
    select MCUX_COMPONENT_driver.common
    select MCUX_DEPENDENCY_COMPONENT_component.use_i2c_dependency_options
    help
      Say yes here to select pca9422 driver.

config MCUX_COMPONENT_driver.pf1550
    bool "pf1550"
    select MCUX_COMPONENT_driver.common
    select MCUX_DEPENDENCY_COMPONENT_component.use_i2c_dependency_options
    help
      Say yes here to select pf1550 driver.

config MCUX_COMPONENT_driver.pf3000
    bool "pf3000"
    select MCUX_COMPONENT_driver.common
    select MCUX_DEPENDENCY_COMPONENT_component.use_i2c_dependency_options
    help
      Say yes here to select pf3000 driver.

config MCUX_COMPONENT_driver.pf5020
    bool "pf5020"
    select MCUX_COMPONENT_driver.common
    select MCUX_DEPENDENCY_COMPONENT_component.use_i2c_dependency_options
    help
      Say yes here to select pf5020 driver.

endmenu
```

## power/Kconfig
```kconfig
# Copyright 2024-2025 NXP
#
# SPDX-License-Identifier: BSD-3-Clause

config MCUX_COMPONENT_component.hal_power
    bool "hal power"
    select MCUX_COMPONENT_component.sm_power

    if MCUX_COMPONENT_component.hal_power
      choice
        prompt "porting layer"
        default MCUX_DEPENDENCY_COMPONENT_component.hal_power_DEPEND_ANYOF_OPTION_1
        config MCUX_DEPENDENCY_COMPONENT_component.hal_power_DEPEND_ANYOF_OPTION_1
          bool "imx95"
          select MCUX_COMPONENT_component.hal_power.imx95

        config MCUX_DEPENDENCY_COMPONENT_component.hal_power_DEPEND_ANYOF_OPTION_2
          bool "imx943"
          select MCUX_COMPONENT_component.hal_power.imx943

      endchoice
    endif

config MCUX_COMPONENT_component.hal_power.imx943
    bool "Component component.hal_power.imx943"
    depends on MCUX_HW_BOARD_imx943evk

config MCUX_COMPONENT_component.hal_power.imx95
    bool "Component component.hal_power.imx95"
    depends on MCUX_HW_BOARD_imx95lpd5evk19 || MCUX_HW_BOARD_imx95lp4xevk15 || MCUX_HW_BOARD_imx95verdinevk
```

## power_manager/Kconfig
```kconfig
# Copyright 2024 NXP
# SPDX-License-Identifier: BSD-3-Clause

config MCUX_COMPONENT_component.power_manager_framework
    bool "Power manager framework"
    default n
    select MCUX_COMPONENT_component.lists
    select MCUX_COMPONENT_driver.common if MCUX_HAS_COMPONENT_driver.common
    select MCUX_COMPONENT_driver.spc if MCUX_HAS_COMPONENT_driver.spc
    select MCUX_COMPONENT_driver.cmc if MCUX_HAS_COMPONENT_driver.cmc
    select MCUX_COMPONENT_driver.wuu if MCUX_HAS_COMPONENT_driver.wuu
    select MCUX_COMPONENT_driver.crc if MCUX_HAS_COMPONENT_driver.crc
    select MCUX_COMPONENT_driver.dcdc_soc if MCUX_HAS_COMPONENT_driver.dcdc_soc
    select MCUX_COMPONENT_driver.gpc_3 if MCUX_HAS_COMPONENT_driver.gpc_3
    select MCUX_COMPONENT_driver.pgmc if MCUX_HAS_COMPONENT_driver.pgmc
    select MCUX_COMPONENT_driver.soc_src if MCUX_HAS_COMPONENT_driver.soc_src
    select MCUX_COMPONENT_driver.pmu_1 if MCUX_HAS_COMPONENT_driver.pmu_1
    select MCUX_COMPONENT_driver.ssarc if MCUX_HAS_COMPONENT_driver.ssarc
    select MCUX_COMPONENT_driver.mcx_spc if MCUX_HAS_COMPONENT_driver.mcx_spc
    select MCUX_COMPONENT_driver.mcx_cmc if MCUX_HAS_COMPONENT_driver.mcx_cmc
    select MCUX_COMPONENT_driver.mcx_vbat if MCUX_HAS_COMPONENT_driver.mcx_vbat
    select MCUX_COMPONENT_driver.vbat if MCUX_HAS_COMPONENT_driver.vbat

    if  MCUX_COMPONENT_component.power_manager_framework

    endif
```

## pwm/Kconfig
```kconfig
# Copyright 2024 NXP
# SPDX-License-Identifier: BSD-3-Clause

config MCUX_COMPONENT_component.pwm_ctimer_adapter
    bool "Enable component.pwm_ctimer_adapter"
    default n
    help
        Enable component.pwm_ctimer_adapter component
    select MCUX_COMPONENT_driver.ctimer
    depends on MCUX_HAS_COMPONENT_driver.ctimer    
    
config MCUX_COMPONENT_component.pwm_ftm_adapter
    bool "Enable component.pwm_ftm_adapter"
    default n
    help
        Enable component.pwm_ftm_adapter component
    select MCUX_COMPONENT_driver.ftm
    depends on MCUX_HAS_COMPONENT_driver.ftm    
    
config MCUX_COMPONENT_component.pwm_tpm_adapter
    bool "Enable component.pwm_tpm_adapter"
    default n
    help
        Enable component.pwm_tpm_adapter component
    select MCUX_COMPONENT_driver.tpm
    depends on MCUX_HAS_COMPONENT_driver.tpm 
```

## reset/Kconfig
```kconfig
# Copyright 2024 NXP
# SPDX-License-Identifier: BSD-3-Clause

config MCUX_COMPONENT_component.reset_adapter
    bool "reset"
    default n
    help
        Enable component.reset_adapter component
```

## reset1/Kconfig
```kconfig
config MCUX_COMPONENT_component.hal_reset
    bool "Component component.hal_reset"
    select MCUX_COMPONENT_component.sm_reset
    
    if MCUX_COMPONENT_component.hal_reset
      choice
        prompt "Component component.hal_reset anyOf 1"
        config MCUX_DEPENDENCY_COMPONENT_component.hal_reset_DEPEND_ANYOF_OPTION_1
          bool "Select MCUX_COMPONENT_component.hal_reset.imx943"
          select MCUX_COMPONENT_component.hal_reset.imx943
          select MCUX_COMPONENT_driver.src1
      endchoice
    endif
    
config MCUX_COMPONENT_component.hal_reset.imx943
    bool "Component component.hal_reset.imx943"
    depends on MCUX_HW_BOARD_imx943evk
```

## rng/Kconfig
```kconfig
# Copyright 2024-2025 NXP
# SPDX-License-Identifier: BSD-3-Clause

menuconfig  MCUX_COMPONENT_component.rng_adapter_interface
    bool "rng"
    help
        Enable component rng_adapter

if MCUX_COMPONENT_component.rng_adapter_interface
    choice MCUX_COMPONENT_component.rng_adapter_selection
        prompt "rng adapter implementation"

        config MCUX_COMPONENT_component.rng_adapter
            bool "rng"
            help
                Enable component.rng_adapter component
            select MCUX_COMPONENT_driver.rng
            depends on MCUX_HAS_COMPONENT_driver.rng

        config CONFIG_MCUX_COMPONENT_component.rnga_adapter
            bool "rnga"
            help
                Enable component.rnga_adapter component
            select MCUX_COMPONENT_driver.rnga
            depends on MCUX_HAS_COMPONENT_driver.rnga

        config MCUX_COMPONENT_component.trng_adapter
            bool "trng"
            help
                Enable component.trng_adapter component
            select MCUX_COMPONENT_driver.trng
            depends on MCUX_HAS_COMPONENT_driver.trng

        config MCUX_COMPONENT_component.JNrng_adapter
            bool "JNrng"
            help
                Enable component.JNrng_adapter component
            select MCUX_COMPONENT_driver.jn_rng
            depends on MCUX_HAS_COMPONENT_driver.jn_rng

        config MCUX_COMPONENT_component.ele_trng_adapter
            bool "ele trng"
            help
                Enable component.ele_trng_adapter component
            select MCUX_COMPONENT_middleware.secure-subsystem
            select MCUX_COMPONENT_middleware.secure-subsystem.elemu.port_kw45_k4w1
            depends on MCUX_HAS_COMPONENT_driver.elemu
            
        config MCUX_COMPONENT_component.software_rng_adapter
            bool "software_rng"
            help
                Enable component.software_rng_adapter component
    endchoice
endif
```
