## rpmsg/Kconfig
```kconfig
# Copyright 2024 NXP
# SPDX-License-Identifier: BSD-3-Clause

config MCUX_COMPONENT_component.rpmsg_adapter
    bool "Use rpmsg adapter"
    default n
    select MCUX_COMPONENT_driver.common
    select MCUX_COMPONENT_middleware.multicore.rpmsg-lite
    help
        Enable component.rpmsg_adapter component
    if MCUX_COMPONENT_component.rpmsg_adapter
      choice
        prompt "Component component.rpmsg_adapter anyOf 1"
        default MCUX_DEPENDENCY_COMPONENT_component.rpmsg_adapter_framework_rpmsg_config
        config MCUX_DEPENDENCY_COMPONENT_component.rpmsg_adapter_framework_rpmsg_config
            bool "Component MCUX_DEPENDENCY_COMPONENT_component.rpmsg_adapter_framework_rpmsg_config"
            depends on MCUX_HW_BOARD_kw45b41zevk || MCUX_HW_BOARD_kw45b41zloc || MCUX_HW_BOARD_kw47evk || MCUX_HW_BOARD_frdmmcxw7x
            
        config MCUX_DEPENDENCY_COMPONENT_component.rpmsg_adapter.generated_rpmsg_config
            bool "Component MCUX_DEPENDENCY_COMPONENT_component.rpmsg_adapter.generated_rpmsg_config"         

      endchoice
      menu "RPMSG adapter config" 
        config HAL_RPMSG_SELECT_ROLE
            bool "HAL_RPMSG_SELECT_ROLE"
            default y
            help
                RPMSG Msaster/Remote role definition (0 - Master, 1 - Remote)
                No prefix in generated macro
      endmenu
    endif
```

## rtc/Kconfig
```kconfig
# Copyright 2024 NXP
# SPDX-License-Identifier: BSD-3-Clause

config MCUX_COMPONENT_component.rtc_adapter
    bool "rtc"
    default n
    help
        Enable component.rtc_adapter component
    select MCUX_COMPONENT_driver.rtc
    depends on MCUX_HAS_COMPONENT_driver.rtc

config MCUX_COMPONENT_component.lpcrtc
    bool "lpcrtc"
    default n
    help
        Enable component.lpcrtc component
    select MCUX_COMPONENT_driver.lpc_rtc
    depends on MCUX_HAS_COMPONENT_driver.lpc_rtc

config MCUX_COMPONENT_component.rtc_bbnsm_adapter
    bool "rtc_bbnsm"
    default n
    help
        Enable component.rtc_bbnsm_adapter component
    select MCUX_COMPONENT_driver.bbnsm
    depends on MCUX_HAS_COMPONENT_driver.bbnsm
```

## rtt/Kconfig
```kconfig
# Copyright 2024-2025 NXP
# SPDX-License-Identifier: BSD-3-Clause

menu "rtt"
    config MCUX_COMPONENT_driver.rtt.template
        bool "rtt.template"

    config MCUX_COMPONENT_driver.rtt
        bool "rtt"
        select MCUX_COMPONENT_driver.rtt.template
endmenu
```

## scmi/Kconfig
```kconfig
# Copyright 2024 NXP
# SPDX-License-Identifier: BSD-3-Clause

config MCUX_COMPONENT_component.sm.scmi
    bool "sm.scmi"
    default n
    help
	Enable component.sm.scmi component
```

## sdu/Kconfig
```kconfig
# Copyright 2024 NXP
# SPDX-License-Identifier: BSD-3-Clause

config MCUX_COMPONENT_component.sdu_adapter
    bool "sdu"
    select MCUX_COMPONENT_driver.sdu
    select MCUX_COMPONENT_component.osa
```

## sensor/Kconfig
```kconfig
# Copyright 2024-2025 NXP
# SPDX-License-Identifier: BSD-3-Clause

menu "Sensor Drivers"
config MCUX_DEPENDENCY_COMPONENT_component.sensor_use_i2c_dependency_options
    bool
    select MCUX_COMPONENT_driver.flexcomm_i2c if MCUX_HAS_COMPONENT_driver.flexcomm_i2c
    select MCUX_COMPONENT_driver.i2c if MCUX_HAS_COMPONENT_driver.i2c
    select MCUX_COMPONENT_driver.ii2c if MCUX_HAS_COMPONENT_driver.ii2c
    select MCUX_COMPONENT_driver.lpc_i2c if MCUX_HAS_COMPONENT_driver.lpc_i2c
    select MCUX_COMPONENT_driver.lpc_i2c_1 if MCUX_HAS_COMPONENT_driver.lpc_i2c_1
    select MCUX_COMPONENT_driver.lpflexcomm_lpi2c if MCUX_HAS_COMPONENT_driver.lpflexcomm_lpi2c
    select MCUX_COMPONENT_driver.lpi2c if MCUX_HAS_COMPONENT_driver.lpi2c
    select MCUX_COMPONENT_driver.dsc_i2c if MCUX_HAS_COMPONENT_driver.dsc_i2c
    select MCUX_COMPONENT_driver.dsc_lpi2c if MCUX_HAS_COMPONENT_driver.dsc_lpi2c

config MCUX_COMPONENT_driver.fxas21002cq
    bool "fxas21002cq"
    select MCUX_COMPONENT_driver.common
    select MCUX_DEPENDENCY_COMPONENT_component.sensor_use_i2c_dependency_options

config MCUX_COMPONENT_driver.fxls8974cf
    bool "fxls8974cf"
    select MCUX_COMPONENT_driver.common
    select MCUX_DEPENDENCY_COMPONENT_component.sensor_use_i2c_dependency_options

config MCUX_COMPONENT_driver.fxos8700cq
    bool "fxos8700cq"
    select MCUX_COMPONENT_driver.common
    select MCUX_DEPENDENCY_COMPONENT_component.sensor_use_i2c_dependency_options

config MCUX_COMPONENT_driver.htu21d
    bool "htu21d"
    select MCUX_COMPONENT_driver.common
    select MCUX_DEPENDENCY_COMPONENT_component.sensor_use_i2c_dependency_options

config MCUX_COMPONENT_driver.icm42688p
    bool "icm42688p"
    select MCUX_COMPONENT_driver.common
    select MCUX_DEPENDENCY_COMPONENT_component.sensor_use_i2c_dependency_options

config MCUX_COMPONENT_driver.max30101
    bool "max30101"
    select MCUX_COMPONENT_driver.common
    select MCUX_DEPENDENCY_COMPONENT_component.sensor_use_i2c_dependency_options

config MCUX_COMPONENT_driver.mma8451q
    bool "mma8451q"
    select MCUX_COMPONENT_driver.common
    select MCUX_DEPENDENCY_COMPONENT_component.sensor_use_i2c_dependency_options

config MCUX_COMPONENT_driver.mma8652fc
    bool "mma8652fc"
    select MCUX_COMPONENT_driver.common
    select MCUX_DEPENDENCY_COMPONENT_component.sensor_use_i2c_dependency_options

config MCUX_COMPONENT_driver.mpl3115a2
    bool "mpl3115a2"
    select MCUX_COMPONENT_driver.common
    select MCUX_COMPONENT_driver.timer_lptmr
    select MCUX_DEPENDENCY_COMPONENT_component.sensor_use_i2c_dependency_options

config MCUX_COMPONENT_driver.p3t1755
    bool "p3t1755"
    select MCUX_COMPONENT_driver.common
    select MCUX_DEPENDENCY_COMPONENT_component.sensor_use_i2c_dependency_options

config MCUX_COMPONENT_driver.tsl2561
    bool "tsl2561"
    select MCUX_COMPONENT_driver.common
    select MCUX_DEPENDENCY_COMPONENT_component.sensor_use_i2c_dependency_options

config MCUX_COMPONENT_driver.lsm6dso
    bool "lsm6dso"
    select MCUX_COMPONENT_driver.common
    select MCUX_DEPENDENCY_COMPONENT_component.sensor_use_i2c_dependency_options
endmenu
```
