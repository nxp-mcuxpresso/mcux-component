## cmsis_drivers/cmsis_enet/Kconfig
```kconfig
# Copyright 2024-2026 NXP
# SPDX-License-Identifier: Apache-2.0

config MCUX_HAS_COMPONENT_driver.cmsis_enet
    bool
    default y if MCUX_HW_IP_DriverType_ENET

config MCUX_COMPONENT_driver.cmsis_enet
    bool "enet"
    select MCUX_COMPONENT_driver.enet
    select MCUX_COMPONENT_driver.cmsis_enet_phy
    select MCUX_COMPONENT_CMSIS_Driver_Include.Ethernet_MAC
    select MCUX_COMPONENT_CMSIS_Driver_Include.Ethernet
    select MCUX_COMPONENT_device.RTE
    depends on MCUX_HAS_COMPONENT_driver.cmsis_enet
```

## cmsis_drivers/cmsis_enet_phy/Kconfig
```kconfig
# Copyright 2024-2026 NXP
# SPDX-License-Identifier: Apache-2.0

config MCUX_HAS_COMPONENT_driver.cmsis_enet_phy
    bool
    default y

config MCUX_COMPONENT_driver.cmsis_enet_phy
    bool "enet_phy"
    select MCUX_COMPONENT_CMSIS_Driver_Include.Ethernet_PHY
    select MCUX_COMPONENT_CMSIS_Driver_Include.Ethernet
    select MCUX_COMPONENT_device.RTE
    select MCUX_COMPONENT_component.eth_phy_common
    depends on MCUX_HAS_COMPONENT_driver.cmsis_enet_phy
```

## cmsis_drivers/cmsis_mcx_enet/Kconfig
```kconfig
# Copyright 2026 NXP
# SPDX-License-Identifier: Apache-2.0

config MCUX_HAS_COMPONENT_driver.cmsis_mcx_enet
    bool
    default y if MCUX_HW_IP_DriverType_MCX_ENET

config MCUX_COMPONENT_driver.cmsis_mcx_enet
    bool "mcx_enet"
    select MCUX_COMPONENT_driver.mcx_enet
    select MCUX_COMPONENT_driver.cmsis_enet_phy
    select MCUX_COMPONENT_CMSIS_Driver_Include.Ethernet_MAC
    select MCUX_COMPONENT_CMSIS_Driver_Include.Ethernet
    select MCUX_COMPONENT_device.RTE
    depends on MCUX_HAS_COMPONENT_driver.cmsis_mcx_enet
```

## cmsis_drivers/cmsis_mcx_flash/Kconfig
```kconfig
# Copyright 2026 NXP
# SPDX-License-Identifier: Apache-2.0

config MCUX_HAS_COMPONENT_driver.cmsis_mcx_flash
    bool
    default y if MCUX_HAS_COMPONENT_driver.romapi

config MCUX_COMPONENT_driver.cmsis_mcx_flash
    bool "mcx_flash"
    select MCUX_COMPONENT_driver.romapi_flashiap
    select MCUX_COMPONENT_CMSIS_Driver_Include.Flash
    select MCUX_COMPONENT_device.RTE
    depends on MCUX_HAS_COMPONENT_driver.cmsis_mcx_flash
```

## ele_base_api/Kconfig
```kconfig
# Copyright 2024 NXP
# SPDX-License-Identifier: BSD-3-Clause

menu "ELE Base API"

    config MCUX_COMPONENT_component.ele_base_api
        bool "ele_base_api"
        select MCUX_COMPONENT_driver.s3mu

    config ELE_HAS_V2X_FW_BRINGUP
        bool "Enable ELE V2X firmware bring-up API"
        default n
        depends on MCUX_COMPONENT_component.ele_base_api
        help
          No prefix in generated macro
          Compile in the EdgeLock enclave (ELE) V2X firmware bring-up API
          (authenticate/start the V2X firmware core). Only SoCs that
          integrate a V2X firmware core should select this option; it is
          disabled by default.

endmenu
```

## ele_crypto/Kconfig
```kconfig
# Copyright 2024-2026 NXP
# SPDX-License-Identifier: BSD-3-Clause

menu "ELE Crypto"

  config MCUX_COMPONENT_component.ele_crypto
      bool "ele_crypto"
      select MCUX_COMPONENT_driver.s3mu

      if MCUX_COMPONENT_component.ele_crypto
        # ELE firmware variant: S400 (RT1180) or S100 (RT2660)
        choice MCUX_DEPENDENCY_COMPONENT_component.ele_crypto.variant
          prompt "ELE firmware variant"
          default MCUX_COMPONENT_component.ele_crypto_s400 if MCUX_HW_IP_DriverType_EDGELOCK
          default MCUX_COMPONENT_component.ele_crypto_s100 if MCUX_HW_IP_DriverType_S3MU

          config MCUX_COMPONENT_component.ele_crypto_s400
              bool "ELE S400 (RT1180, ELE400/ELE401)"
              depends on MCUX_HW_IP_DriverType_EDGELOCK
              help
                Use the S400 ELE firmware backend (ele_crypto.c).  This is the
                variant present on i.MX RT1180 with the ELE400 or ELE401 IP.

          config MCUX_COMPONENT_component.ele_crypto_s100
              bool "ELE S100 (RT2660)"
              depends on MCUX_HW_IP_DriverType_S3MU
              help
                Use the S100 ELE firmware backend (ele_crypto_s100.c).  This is
                the variant present on i.MX RT2660.

        endchoice

        choice MCUX_DEPENDENCY_COMPONENT_component.ele_crypto.cache_driver
          prompt "ele_crypto cache dependency"
          default MCUX_DEPENDENCY_COMPONENT_component.ele_crypto_CM7_CACHE
          config MCUX_DEPENDENCY_COMPONENT_component.ele_crypto_CM7_CACHE
              bool "MCUX_DEPENDENCY_COMPONENT_component.ele_crypto_CM7_CACHE"
              select MCUX_COMPONENT_driver.memory
              select MCUX_COMPONENT_driver.cache_armv7_m7
              depends on MCUX_HW_CORE_CM7F

          config MCUX_DEPENDENCY_COMPONENT_component.ele_crypto_CM33_XCACHE
              bool "MCUX_DEPENDENCY_COMPONENT_component.ele_crypto_CM33_XCACHE"
              select MCUX_COMPONENT_driver.cache_xcache
              depends on MCUX_HW_CORE_CM33

          config MCUX_DEPENDENCY_COMPONENT_component.ele_crypto_CM85_CACHE
              bool "MCUX_DEPENDENCY_COMPONENT_component.ele_crypto_CM85_CACHE"
              select MCUX_COMPONENT_driver.memory
              select MCUX_COMPONENT_driver.cache_armv7_m7
              depends on MCUX_HW_CORE_CM85

        endchoice
      endif

  config MCUX_COMPONENT_component.ele_nvm_manager
      bool "ele_nvm_manager"
      default y if MCUX_COMPONENT_component.ele_crypto
      depends on MCUX_COMPONENT_component.ele_crypto
      help
        NVM manager task for ELE key store persistence.  Required for both
        S400 and S100 variants when persistent keys (SYNC flag) are used.

endmenu
```

## gpio/Kconfig
```kconfig
# Copyright 2024 NXP
# SPDX-License-Identifier: BSD-3-Clause

config MCUX_COMPONENT_component.gpio_adapter
    bool "gpio"
    default n
    help
        Enable component.gpio_adapter component

    select MCUX_COMPONENT_driver.gpio
    depends on MCUX_HAS_COMPONENT_driver.gpio
    if MCUX_COMPONENT_component.gpio_adapter
        choice
            prompt "MCUX_COMPONENT_component.gpio_adapter option 1"
            default MCUX_DEPENDENCY_COMPONENT_component.gpio_adapter_DEPEND_COMPONENT_OPTION_1 if !MCUX_HW_DEVICE_ID_MIMXRT798S && !MCUX_HW_DEVICE_ID_MIMXRT2660xxxxx && !MCUX_HW_DEVICE_ID_MIMXRT2661xxxxx && !MCUX_HW_DEVICE_ID_MIMXRT2662xxxxx && !MCUX_HW_DEVICE_ID_MIMXRT2663xxxxx
            default MCUX_DEPENDENCY_COMPONENT_component.gpio_adapter_DEPEND_COMPONENT_OPTION_2 if MCUX_HW_DEVICE_ID_MIMXRT798S || MCUX_HW_DEVICE_ID_MIMXRT2660xxxxx || MCUX_HW_DEVICE_ID_MIMXRT2661xxxxx || MCUX_HW_DEVICE_ID_MIMXRT2662xxxxx || MCUX_HW_DEVICE_ID_MIMXRT2663xxxxx
            config MCUX_DEPENDENCY_COMPONENT_component.gpio_adapter_DEPEND_COMPONENT_OPTION_1
                bool "Select driver.port"
                select MCUX_COMPONENT_driver.port
            config MCUX_DEPENDENCY_COMPONENT_component.gpio_adapter_DEPEND_COMPONENT_OPTION_2
                bool "Select MIMXRT798S or MIMXRT2660 family (no driver.port)"
                depends on MCUX_HW_DEVICE_ID_MIMXRT798S || MCUX_HW_DEVICE_ID_MIMXRT2660xxxxx || MCUX_HW_DEVICE_ID_MIMXRT2661xxxxx || MCUX_HW_DEVICE_ID_MIMXRT2662xxxxx || MCUX_HW_DEVICE_ID_MIMXRT2663xxxxx
        endchoice
    endif


config MCUX_COMPONENT_component.lpc_gpio_adapter
    bool "lpc_gpio"
    default n
    help
        Enable component.lpc_gpio_adapter component
    select MCUX_COMPONENT_driver.lpc_gpio
    select MCUX_COMPONENT_driver.inputmux
    select MCUX_COMPONENT_driver.pint
    depends on MCUX_HAS_COMPONENT_driver.lpc_gpio

config MCUX_COMPONENT_component.igpio_adapter
    bool "igpio"
    default n
    help
        Enable component.igpio_adapter component
    select MCUX_COMPONENT_driver.igpio
    depends on MCUX_HAS_COMPONENT_driver.igpio

config MCUX_COMPONENT_component.gint_adapter
    bool "gint"
    default n
    help
        Enable component.gint_adapter component
    select MCUX_COMPONENT_driver.gint
    depends on MCUX_HAS_COMPONENT_driver.gint

config MCUX_COMPONENT_component.dsc_gpio_adapter
    bool "dsc_gpio"
    default n
    help
        Enable component.dsc_gpio_adapter component
    select MCUX_COMPONENT_driver.dsc_gpio
    depends on MCUX_HAS_COMPONENT_driver.dsc_gpio


config MCUX_COMPONENT_component.rgpio_adapter
    bool "rgpio"
    default n
    help
        Enable component.rgpio_adapter component
    select MCUX_COMPONENT_driver.rgpio
    depends on MCUX_HAS_COMPONENT_driver.rgpio

config MCUX_COMPONENT_component.rt_gpio_adapter
    bool "rt_gpio"
    default n
    help
        Enable component.rt_gpio_adapter component
    select MCUX_COMPONENT_driver.lpc_gpio
    depends on MCUX_HAS_COMPONENT_driver.lpc_gpio
```

## semihost/Kconfig
```kconfig
# Copyright 2026 NXP
# SPDX-License-Identifier: BSD-3-Clause

config MCUX_COMPONENT_utility.semihost
    bool "semihost"
    depends on CPU_CORTEX_M
    help
      ARM semihosting host-call layer (BKPT 0xAB) plus a libc-free direct file
      API (SEMIHOST_Open/Read/Seek/Flen/Close; writes reuse SEMIHOST_Write),
      the toolchain-independent alternative to semihost_file. Cortex-M only.

config MCUX_COMPONENT_utility.semihost_console
    bool "semihost_console"
    depends on CPU_CORTEX_M
    select MCUX_COMPONENT_utility.semihost
    help
      Retargets the C library's low-level write (_write / __write / fputc) so
      standard printf/puts reach the debugger over semihosting. Coexists with
      debug_console: the SDK PRINTF stays on UART, C printf goes to semihosting.
      To route existing PRINTF sites instead, build -DSDK_DEBUGCONSOLE=0 and
      leave SDK_DEBUGCONSOLE_UART undefined (or prefer debug_console_semihost).

config MCUX_COMPONENT_utility.semihost_file
    bool "semihost_file"
    depends on CPU_CORTEX_M
    select MCUX_COMPONENT_utility.semihost_console
    help
      Retargets the C library's low-level file I/O (newlib _open/_read/...;
      IAR DLib __open/__read/...; ARM Compiler _sys_open/_sys_read/...) so
      standard fopen/fwrite/fread/fseek/fclose hit host files over semihosting.
      IAR needs --dlib_config DLib_Config_Full.h (Normal DLib omits FILE). Not
      available under MDK MicroLib (no file-system layer; compiles empty). The
      ARM Compiler branch is not CI-verified. For a libc-free alternative, use
      the direct SEMIHOST_* API in the base unit.

config MCUX_COMPONENT_utility.debug_console_semihost
    bool "debug_console_semihost"
    depends on CPU_CORTEX_M
    depends on !MCUX_COMPONENT_utility.debug_console && !MCUX_COMPONENT_utility.debug_console_lite && !MCUX_COMPONENT_utility.debug_console_rtt
    select MCUX_COMPONENT_utility.semihost
    select MCUX_COMPONENT_utility.str
    help
      Debug-console backend routing the SDK PRINTF to semihosting instead of a
      UART, replacing debug_console at the board level (unlike semihost_console,
      which only adds a _write override alongside the UART console). Ships its
      own fsl_debug_console.h; PRINTF maps to DbgConsole_Printf (a function, not
      the toolchain printf, so no -Wformat), with the 4-arg DbgConsole_Init so
      board files build unchanged. Mutually exclusive with the other
      debug_console variants.
```
