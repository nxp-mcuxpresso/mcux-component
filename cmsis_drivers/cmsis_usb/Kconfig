## cmsis_drivers/cmsis_usb/Kconfig
```kconfig
# Copyright 2026 NXP
# SPDX-License-Identifier: Apache-2.0

config MCUX_HAS_COMPONENT_driver.cmsis_usb
    bool
    default y if MCUX_HW_IP_DriverType_USB_HOST_DEVICE_EHCI

config MCUX_COMPONENT_driver.cmsis_usb
    bool "usb (CMSIS-Driver USBD EHCI)"
    select MCUX_COMPONENT_middleware.usb.device.ehci
    select MCUX_COMPONENT_middleware.usb.phy
    select MCUX_COMPONENT_CMSIS_Driver_Include.USB_Device
    depends on MCUX_HAS_COMPONENT_driver.cmsis_usb
```

## datetime/Kconfig
```kconfig
# Copyright 2026 NXP
# SPDX-License-Identifier: BSD-3-Clause

config MCUX_COMPONENT_component.datetime
    bool "datetime"
    default n
    help
	Enable component.datetime component, calendar date and time helpers
```

## scmi/Kconfig
```kconfig
# Copyright 2024 NXP
# SPDX-License-Identifier: BSD-3-Clause

config MCUX_COMPONENT_component.sm.scmi
    bool "sm.scmi"
    default n
    select MCUX_COMPONENT_component.datetime
    help
	Enable component.sm.scmi component
```
