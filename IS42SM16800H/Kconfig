## cmsis_drivers/cmsis_lpc_vspi/Kconfig
```kconfig
# Copyright 2024-2025 NXP
# SPDX-License-Identifier: Apache-2.0

config MCUX_HAS_COMPONENT_driver.cmsis_vspi
    bool
    default y if MCUX_HW_IP_DriverType_LPC_SPI

config MCUX_COMPONENT_driver.cmsis_vspi
    bool "vspi"
    select MCUX_COMPONENT_driver.vspi
    select MCUX_COMPONENT_CMSIS_Driver_Include.SPI
    select MCUX_COMPONENT_device.RTE
    select MCUX_COMPONENT_driver.vspi_dma
    depends on MCUX_HAS_COMPONENT_driver.cmsis_vspi
```

## cmsis_drivers/cmsis_lpc_vusart/Kconfig
```kconfig
# Copyright 2024-2025 NXP
# SPDX-License-Identifier: Apache-2.0

config MCUX_HAS_COMPONENT_driver.cmsis_vusart
    bool
    default y if MCUX_HW_IP_DriverType_LPC_USART

config MCUX_COMPONENT_driver.cmsis_vusart
    bool "vusart"
    select MCUX_COMPONENT_driver.vusart
    select MCUX_COMPONENT_CMSIS_Driver_Include.USART
    select MCUX_COMPONENT_device.RTE
    select MCUX_COMPONENT_driver.vusart_dma
    depends on MCUX_HAS_COMPONENT_driver.cmsis_vusart
```

## cmsis_drivers/cmsis_lpi2c/Kconfig
```kconfig
config MCUX_HAS_COMPONENT_driver.cmsis_lpi2c
    bool
    default y if MCUX_HW_IP_DriverType_LPI2C || MCUX_HW_IP_DriverType_LPFLEXCOMM_LPI2C

config MCUX_COMPONENT_driver.cmsis_lpi2c
    bool "lpi2c"
    select MCUX_COMPONENT_driver.lpi2c if MCUX_HW_IP_DriverType_LPI2C
    select MCUX_COMPONENT_driver.lpflexcomm_lpi2c if MCUX_HW_IP_DriverType_LPFLEXCOMM_LPI2C
    select MCUX_COMPONENT_CMSIS_Driver_Include.I2C
    select MCUX_COMPONENT_device.RTE
    depends on MCUX_HAS_COMPONENT_driver.cmsis_lpi2c
```

## cmsis_drivers/cmsis_lpsci/Kconfig
```kconfig
config MCUX_HAS_COMPONENT_driver.cmsis_lpsci
    bool
    default y if MCUX_HW_IP_DriverType_LPSCI

config MCUX_COMPONENT_driver.cmsis_lpsci
    bool "lpsci"
    select MCUX_COMPONENT_CMSIS_Driver_Include.USART
    select MCUX_COMPONENT_device.RTE
    depends on MCUX_HAS_COMPONENT_driver.cmsis_lpsci
```

## cmsis_drivers/cmsis_lpspi/Kconfig
```kconfig
# Copyright 2024-2025 NXP
# SPDX-License-Identifier: Apache-2.0

config MCUX_HAS_COMPONENT_driver.cmsis_lpspi
    bool
    default y if MCUX_HW_IP_DriverType_LPSPI || MCUX_HW_IP_DriverType_LPFLEXCOMM_LPSPI

config MCUX_COMPONENT_driver.cmsis_lpspi
    bool "lpspi"
    select MCUX_COMPONENT_driver.lpspi if MCUX_HW_IP_DriverType_LPSPI
    select MCUX_COMPONENT_driver.lpflexcomm_lpspi if MCUX_HW_IP_DriverType_LPFLEXCOMM_LPSPI
    select MCUX_COMPONENT_CMSIS_Driver_Include.SPI
    select MCUX_COMPONENT_device.RTE
    depends on MCUX_HAS_COMPONENT_driver.cmsis_lpspi
```

## cmsis_drivers/cmsis_lpuart/Kconfig
```kconfig
# Copyright 2024-2025 NXP
# SPDX-License-Identifier: Apache-2.0

config MCUX_HAS_COMPONENT_driver.cmsis_lpuart
    bool
    default y if MCUX_HW_IP_DriverType_LPUART || MCUX_HW_IP_DriverType_LPFLEXCOMM_LPUART

config MCUX_COMPONENT_driver.cmsis_lpuart
    bool "lpuart"
    select MCUX_COMPONENT_driver.lpuart if MCUX_HW_IP_DriverType_LPUART
    select MCUX_COMPONENT_driver.lpflexcomm_lpuart if MCUX_HW_IP_DriverType_LPFLEXCOMM_LPUART
    select MCUX_COMPONENT_CMSIS_Driver_Include.USART
    select MCUX_COMPONENT_device.RTE
    depends on MCUX_HAS_COMPONENT_driver.cmsis_lpuart
```

## cmsis_drivers/cmsis_spi/Kconfig
```kconfig
# Copyright 2024-2025 NXP
# SPDX-License-Identifier: Apache-2.0

config MCUX_HAS_COMPONENT_driver.cmsis_spi
    bool
    default y if MCUX_HW_IP_DriverType_SPI

config MCUX_COMPONENT_driver.cmsis_spi
    bool "spi"
    select MCUX_COMPONENT_driver.spi
    select MCUX_COMPONENT_CMSIS_Driver_Include.SPI
    select MCUX_COMPONENT_device.RTE
    depends on MCUX_HAS_COMPONENT_driver.cmsis_spi
```

## cmsis_drivers/cmsis_uart/Kconfig
```kconfig
# Copyright 2024-2025 NXP
# SPDX-License-Identifier: Apache-2.0

config MCUX_HAS_COMPONENT_driver.cmsis_uart
    bool
    default y if MCUX_HW_IP_DriverType_UART || MCUX_HW_IP_DriverType_UART_ISO7816

config MCUX_COMPONENT_driver.cmsis_uart
    bool "uart"
    select MCUX_COMPONENT_driver.uart
    select MCUX_COMPONENT_CMSIS_Driver_Include.USART
    select MCUX_COMPONENT_device.RTE
    depends on MCUX_HAS_COMPONENT_driver.cmsis_uart
```

## codec/Kconfig
```kconfig
# Copyright 2024 NXP
# SPDX-License-Identifier: BSD-3-Clause

config MCUX_COMPONENT_component.codec_i2c
    bool
    select MCUX_COMPONENT_component.i2c_adapter_interface

config MCUX_COMPONENT_driver.codec
    bool

config MCUX_COMPONENT_component.codec_adapters
    bool

config MCUX_COMPONENT_component.wm8904_adapter
    bool

config MCUX_COMPONENT_component.wm8960_adapter
    bool

config MCUX_COMPONENT_component.wm8962_adapter
    bool

config MCUX_COMPONENT_component.wm8524_adapter
    bool

config MCUX_COMPONENT_component.sgtl_adapter
    bool

config MCUX_COMPONENT_component.da7212_adapter
    bool

config MCUX_COMPONENT_component.ak4497_adapter
    bool

config MCUX_COMPONENT_component.tfa9xxx_adapter
    bool

config MCUX_COMPONENT_component.tfa9896_adapter
    bool

config MCUX_COMPONENT_component.cs42888_adapter
    bool

config MCUX_COMPONENT_component.cs42448_adapter
    bool

config MCUX_COMPONENT_component.pcm186x_adapter
    bool

config MCUX_COMPONENT_component.pcm512x_adapter
    bool

config MCUX_COMPONENT_driver.ak4497
    bool "Use ak4497 codec driver"
    select MCUX_COMPONENT_component.codec_i2c
    select MCUX_COMPONENT_driver.codec
    select MCUX_COMPONENT_component.ak4497_adapter
    select MCUX_COMPONENT_component.codec_adapters

config MCUX_COMPONENT_driver.cs42448
    bool "Use cs42448 codec driver"
    select MCUX_COMPONENT_component.codec_i2c
    select MCUX_COMPONENT_driver.codec
    select MCUX_COMPONENT_component.cs42448_adapter
    select MCUX_COMPONENT_component.codec_adapters

config MCUX_COMPONENT_driver.cs42888
    bool "Use cs42888 codec driver"
    select MCUX_COMPONENT_component.codec_i2c
    select MCUX_COMPONENT_driver.codec
    select MCUX_COMPONENT_component.cs42888_adapter
    select MCUX_COMPONENT_component.codec_adapters

config MCUX_COMPONENT_driver.dialog7212
    bool "Use da7212 codec driver"
    select MCUX_COMPONENT_component.codec_i2c
    select MCUX_COMPONENT_driver.codec
    select MCUX_COMPONENT_component.da7212_adapter
    select MCUX_COMPONENT_component.codec_adapters

config MCUX_COMPONENT_driver.pcm186x
    bool "Use pcm186x codec driver"
    select MCUX_COMPONENT_component.codec_i2c
    select MCUX_COMPONENT_driver.codec
    select MCUX_COMPONENT_component.pcm186x_adapter
    select MCUX_COMPONENT_component.codec_adapters

config MCUX_COMPONENT_driver.pcm512x
    bool "Use pcm512x codec driver"
    select MCUX_COMPONENT_component.codec_i2c
    select MCUX_COMPONENT_driver.codec
    select MCUX_COMPONENT_component.pcm512x_adapter
    select MCUX_COMPONENT_component.codec_adapters

config MCUX_COMPONENT_driver.sgtl5000
    bool "Use sgtl5000 codec driver"
    select MCUX_COMPONENT_component.codec_i2c
    select MCUX_COMPONENT_driver.codec
    select MCUX_COMPONENT_component.sgtl_adapter
    select MCUX_COMPONENT_component.codec_adapters

config MCUX_COMPONENT_driver.tfa9xxx
    bool "Use tfa9xxx codec driver"
    select MCUX_COMPONENT_component.codec_i2c
    select MCUX_COMPONENT_driver.codec
    select MCUX_COMPONENT_component.tfa9xxx_adapter
    select MCUX_COMPONENT_component.codec_adapters

config MCUX_COMPONENT_driver.tfa9xxx_hal
    bool "Use tfa9xxx_hal codec driver"
    select MCUX_COMPONENT_component.codec_i2c
    select MCUX_COMPONENT_driver.tfa9xxx
    select MCUX_COMPONENT_driver.codec
    select MCUX_COMPONENT_component.codec_adapters

config MCUX_COMPONENT_driver.tfa9896
    bool "Use tfa9896 codec driver"
    select MCUX_COMPONENT_component.codec_i2c
    select MCUX_COMPONENT_driver.codec
    select MCUX_COMPONENT_component.tfa9896_adapter
    select MCUX_COMPONENT_component.codec_adapters

config MCUX_COMPONENT_driver.wm8524
    bool "Use wm8524 codec driver"
    select MCUX_COMPONENT_component.codec_i2c
    select MCUX_COMPONENT_driver.codec
    select MCUX_COMPONENT_component.wm8524_adapter
    select MCUX_COMPONENT_component.codec_adapters

config MCUX_COMPONENT_driver.wm8904
    bool "Use wm8904 codec driver"
    select MCUX_COMPONENT_component.codec_i2c
    select MCUX_COMPONENT_driver.codec
    select MCUX_COMPONENT_component.wm8904_adapter
    select MCUX_COMPONENT_component.codec_adapters

config MCUX_COMPONENT_driver.wm8960
    bool "Use wm8960 codec driver"
    select MCUX_COMPONENT_component.codec_i2c
    select MCUX_COMPONENT_driver.codec
    select MCUX_COMPONENT_component.wm8960_adapter
    select MCUX_COMPONENT_component.codec_adapters

config MCUX_COMPONENT_driver.wm8962
    bool "Use wm8962 codec driver"
    select MCUX_COMPONENT_component.codec_i2c
    select MCUX_COMPONENT_driver.codec
    select MCUX_COMPONENT_component.wm8962_adapter
    select MCUX_COMPONENT_component.codec_adapters
```
