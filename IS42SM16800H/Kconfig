## IS42SM16800H/Kconfig
```kconfig
# Copyright 2024 NXP
# SPDX-License-Identifier: BSD-3-Clause

config MCUX_COMPONENT_driver.IS42SM16800H
    bool "IS42SM16800H"
    select MCUX_COMPONENT_driver.sdramc
```

## Kconfig
```kconfig
# Copyright 2024-2025 NXP
# SPDX-License-Identifier: BSD-3-Clause

menu "Component Configuration"

    menu "AWS IoT"
        rsource "aws_iot/Kconfig"
    endmenu

    menu "CMSIS Drivers"
        rsource "cmsis_drivers/cmsis_enet/Kconfig"
        rsource "cmsis_drivers/cmsis_lpc_vusart/Kconfig"
        rsource "cmsis_drivers/cmsis_uart/Kconfig"
        rsource "cmsis_drivers/cmsis_lpuart/Kconfig"
        rsource "cmsis_drivers/cmsis_lpc_i2c/Kconfig"
        rsource "cmsis_drivers/cmsis_lpc_vspi/Kconfig"
        rsource "cmsis_drivers/cmsis_spi/Kconfig"
        rsource "cmsis_drivers/cmsis_ii2c/Kconfig"
        rsource "cmsis_drivers/cmsis_i2c/Kconfig"
        rsource "cmsis_drivers/cmsis_lpi2c/Kconfig"
        rsource "cmsis_drivers/cmsis_lpspi/Kconfig"
        rsource "cmsis_drivers/cmsis_ecspi/Kconfig"
        rsource "cmsis_drivers/cmsis_lpc_gpio/Kconfig"
        rsource "cmsis_drivers/cmsis_flexcomm/Kconfig"
        rsource "cmsis_drivers/cmsis_iuart/Kconfig"
        rsource "cmsis_drivers/cmsis_dspi/Kconfig"
        rsource "cmsis_drivers/cmsis_lpsci/Kconfig"
        rsource "cmsis_drivers/cmsis_gpio/Kconfig"
    endmenu

    menu "Utility"
        rsource "assert/Kconfig"
        rsource "misc_utilities/Kconfig"
        rsource "lists/Kconfig"
        rsource "str/Kconfig"
        rsource "format/Kconfig"
        rsource "silicon_id/Kconfig"
        rsource "notifier/Kconfig"
    endmenu

    menu "Console and Shell"
        rsource "debug_console/Kconfig"
        rsource "debug_console_lite/Kconfig"
        rsource "debug_console_rtt/Kconfig"
        rsource "log/Kconfig"
        rsource "shell/Kconfig"
        rsource "serial_manager/Kconfig"
        rsource "rtt/Kconfig"
    endmenu

    menu "Codec"
        rsource "codec/Kconfig"
    endmenu

    menu "Peripheral Adaptor"
        rsource "button/Kconfig"
        rsource "common_task/Kconfig"
        rsource "crc/Kconfig"
        rsource "extern_flash/Kconfig"
        rsource "gpio/Kconfig"
        rsource "internal_flash/Kconfig"
        rsource "timer/Kconfig"
        rsource "timer_manager/Kconfig"
        rsource "time_stamp/Kconfig"
        rsource "rtc/Kconfig"
        rsource "i2c/Kconfig"
        rsource "i3c_bus/Kconfig"
        rsource "led/Kconfig"
        rsource "mem_manager/Kconfig"
        rsource "messaging/Kconfig"
        rsource "reset/Kconfig"
        rsource "reset1/Kconfig"
        rsource "rng/Kconfig"
        rsource "rpmsg/Kconfig"
        rsource "spi/Kconfig"
        rsource "pwm/Kconfig"
        rsource "uart/Kconfig"
        rsource "lce/Kconfig"
        rsource "imu_adapter/Kconfig"
        rsource "systick_timer/Kconfig"
        rsource "timer_lptmr/Kconfig"
        rsource "audio/Kconfig"
        rsource "adc_sensor/Kconfig"
        rsource "clock/Kconfig"
        rsource "pinctrl/Kconfig"
    endmenu

    menu "Operating System Abstraction (OSA)"
        rsource "osa/Kconfig"
    endmenu

    menu "EdgeFast Wifi"
        orsource "edgefast_wifi/Kconfig"
    endmenu

    rsource "wifi_bt_module/Kconfig"

    # Security
    menu "Security"
        orsource "els_pkc/Kconfig"
        orsource "ele_crypto/Kconfig"
        orsource "ele_base_api/Kconfig"
        orsource "psa_crypto_driver/Kconfig"
        orsource "crypto_benchmark/Kconfig"
    endmenu

    menu "Power"
        rsource "pmic/Kconfig"
        rsource "power_manager/Kconfig"
        rsource "power/Kconfig"
    endmenu

    menu "I/O expander"
        rsource "expander/Kconfig"
        rsource "sx1502/Kconfig"
    endmenu

    rsource "sensor/Kconfig"

    menu "Display and Touch"
        rsource "video/Kconfig"
        rsource "touch/Kconfig"
        rsource "display/Kconfig"
        rsource "slcd_engine/Kconfig"
    endmenu

    menu "ENET PHY"
        rsource "phy/Kconfig"
    endmenu

    menu "SRTM(Simplified Real Time Message, Application Protocol) Components"
        rsource "srtm/Kconfig"
    endmenu

    menu "SDIO"
        rsource "sdu/Kconfig"
    endmenu

    menu "SMBUS"
        rsource "smbus/Kconfig"
    endmenu

    rsource "flash/Kconfig"

    menu "SPI Flash"
        rsource "mx25l_flash/Kconfig"
        rsource "mx25r_flash/Kconfig"
        rsource "mx25_flash/Kconfig"
    endmenu

    menu "External RAM"
        rsource "mt48lc2m32b2/Kconfig"
        rsource "mt48lc4m16a2/Kconfig"
        rsource "IS42SM16800H/Kconfig"
    endmenu

    menu "System Manager"
        rsource "sm/Kconfig"
        rsource "imx_sm_crc/Kconfig"
        rsource "scmi/Kconfig"
        rsource "smt/Kconfig"
    endmenu

    menu "Image Loader"
        rsource "mpi_loader/Kconfig"
        rsource "conn_fwloader/Kconfig"
    endmenu

    menu "Storage"
        rsource "storage/Kconfig"
        rsource "eeprom_emulation/Kconfig"
    endmenu

    menu "Debug"
        rsource "debug/Kconfig"
        rsource "panic/Kconfig"
        rsource "exception_handling/Kconfig"
    endmenu

    menu "Generic Hal"
        rsource "gen_hal/Kconfig"
    endmenu

    menu "Unit Test"
        rsource "unity/Kconfig"
    endmenu

endmenu
```

## adc_sensor/Kconfig
```kconfig
# Copyright 2024-2025 NXP
# SPDX-License-Identifier: BSD-3-Clause

menu "sensor adapter"
    config MCUX_COMPONENT_component.cns_adc_sensor_adapter
        bool "cns_adc"
        select MCUX_COMPONENT_driver.cns_adc

    config MCUX_COMPONENT_component.lpadc_sensor_adapter
        bool "lpadc"
        select MCUX_COMPONENT_driver.lpadc
endmenu
```

## assert/Kconfig
```kconfig
# Copyright 2024 NXP
# SPDX-License-Identifier: BSD-3-Clause

config MCUX_COMPONENT_utility.assert_lite
    bool "assert_lite"
    select MCUX_COMPONENT_driver.common
    select MCUX_COMPONENT_utility.debug_console_lite

    depends on !MCUX_COMPONENT_utility.assert

    if MCUX_COMPONENT_utility.assert_lite

    endif

config MCUX_COMPONENT_utility.assert
    bool "assert"
    select MCUX_COMPONENT_driver.common
    select MCUX_COMPONENT_utility.debug_console

    if MCUX_COMPONENT_utility.assert

    endif

config MCUX_COMPONENT_utility.assert_lite_min
    bool "assert_lite_min"
    depends on MCUX_HW_CORE_DSP56800EX || MCUX_HW_CORE_DSP56800EF
```

## audio/Kconfig
```kconfig
# Copyright 2024 NXP
# SPDX-License-Identifier: BSD-3-Clause

config MCUX_COMPONENT_component.audio_flexcomm_i2s_dma_adapter
    bool "audio_flexcomm_i2s_dma"
    select MCUX_COMPONENT_driver.flexcomm_i2s_dma

config MCUX_COMPONENT_component.audio_sai_dma_adapter
    bool "audio_sai_dma"
    select MCUX_COMPONENT_driver.sai_dma

config MCUX_COMPONENT_component.audio_sai_edma_adapter
    bool "audio_sai_edma"
    select MCUX_COMPONENT_driver.sai_edma
```

## aws_iot/Kconfig
```kconfig
#
# Copyright 2024-2025 NXP
#
# SPDX-License-Identifier: BSD-3-Clause
#

config MCUX_COMPONENT_middleware.iot_reference.logging
    bool "logging"
    select MCUX_COMPONENT_middleware.freertos-kernel

config MCUX_COMPONENT_middleware.iot_reference.transport_mbedtls
    bool "transport_mbedtls"
    select MCUX_COMPONENT_middleware.freertos.coremqtt
    select MCUX_COMPONENT_middleware.freertos.corepkcs11
    select MCUX_COMPONENT_middleware.iot_reference.logging
    select MCUX_COMPONENT_middleware.pkcs11
    select MCUX_COMPONENT_middleware.lwip
    select MCUX_COMPONENT_middleware.mbedtls

config MCUX_COMPONENT_middleware.iot_reference.transport_mbedtls3x
    bool "transport_mbedtls3x"
    select MCUX_COMPONENT_middleware.freertos.corepkcs11
    select MCUX_COMPONENT_middleware.iot_reference.logging
    select MCUX_COMPONENT_middleware.pkcs11
    select MCUX_COMPONENT_middleware.lwip
    select MCUX_COMPONENT_middleware.mbedtls3x

config MCUX_COMPONENT_middleware.iot_reference.transport_mbedtls_psa
    bool "transport_mbedtls_psa"
    select MCUX_COMPONENT_middleware.lwip
    select MCUX_COMPONENT_middleware.iot_reference.logging
```

## button/Kconfig
```kconfig
# Copyright 2024 NXP
# SPDX-License-Identifier: BSD-3-Clause

config MCUX_COMPONENT_component.button
    bool "Enable component.button"
    default n
    help
        Enable component.button component
            
    select MCUX_COMPONENT_component.timer_manager
            
    if MCUX_COMPONENT_component.button
        menu "button config"                    
            config BUTTON_SHORT_PRESS_THRESHOLD
                string "BUTTON_SHORT_PRESS_THRESHOLD"
                default "200U"
                help
                    Definition of button short press threshold,unit is ms.
                    No prefix in generated macro
                    
            config BUTTON_LONG_PRESS_THRESHOLD
                string "BUTTON_LONG_PRESS_THRESHOLD"
                default "500U"
                help
                    Definition of button long press threshold,unit is ms.
                    No prefix in generated macro
                    
            config BUTTON_DOUBLE_CLICK_THRESHOLD
                string "BUTTON_DOUBLE_CLICK_THRESHOLD"
                default "200U"
                help
                    Definition of button double click threshold,unit is ms.
                    No prefix in generated macro               
        endmenu
        choice
            prompt "MCUX_COMPONENT_component.button option 1"
            default MCUX_DEPENDENCY_COMPONENT_component.button_DEPEND_COMPONENT_OPTION_1
            config MCUX_DEPENDENCY_COMPONENT_component.button_DEPEND_COMPONENT_OPTION_1
                bool "Select component.gpio_adapter"
                select MCUX_COMPONENT_component.gpio_adapter
                depends on MCUX_HAS_COMPONENT_driver.gpio
            config MCUX_DEPENDENCY_COMPONENT_component.button_DEPEND_COMPONENT_OPTION_2
                bool "Select component.lpc_gpio_adapter"
                select MCUX_COMPONENT_component.lpc_gpio_adapter
                depends on MCUX_HAS_COMPONENT_driver.lpc_gpio\
                           && !MCUX_HW_BOARD_evkmimxrt595 && !MCUX_HW_BOARD_evkmimxrt685 && !MCUX_HW_BOARD_mimxrt685audevk 
            config MCUX_DEPENDENCY_COMPONENT_component.button_DEPEND_COMPONENT_OPTION_3
                bool "Select component.rt_gpio_adapter"
                select MCUX_COMPONENT_component.rt_gpio_adapter
                depends on MCUX_HAS_COMPONENT_driver.lpc_gpio\
                           || MCUX_HW_BOARD_evkmimxrt595 || MCUX_HW_BOARD_evkmimxrt685 || MCUX_HW_BOARD_mimxrt685audevk 
            config MCUX_DEPENDENCY_COMPONENT_component.button_DEPEND_COMPONENT_OPTION_4
                bool "Select component.igpio_adapter"
                select MCUX_COMPONENT_component.igpio_adapter
                depends on MCUX_HAS_COMPONENT_driver.igpio
            config MCUX_DEPENDENCY_COMPONENT_component.button_DEPEND_COMPONENT_OPTION_5
                bool "Select component.rgpio_adapter"
                select MCUX_COMPONENT_component.rgpio_adapter
                depends on MCUX_HAS_COMPONENT_driver.rgpio
        endchoice
    endif
```

## clock/Kconfig
```kconfig
# Copyright 2024-2025 NXP
#
# SPDX-License-Identifier: BSD-3-Clause

config MCUX_COMPONENT_component.hal_clock
    bool "hal clock"
    select MCUX_COMPONENT_driver.clock
    select MCUX_COMPONENT_component.sm_clock

    if MCUX_COMPONENT_component.hal_clock
      choice
        prompt "porting layers"
        default MCUX_DEPENDENCY_COMPONENT_component.hal_clock_DEPEND_ANYOF_OPTION_1

        config MCUX_DEPENDENCY_COMPONENT_component.hal_clock_DEPEND_ANYOF_OPTION_1
          bool "imx95"
          select MCUX_COMPONENT_component.hal_clock.imx95

        config MCUX_DEPENDENCY_COMPONENT_component.hal_clock_DEPEND_ANYOF_OPTION_2
          bool "imx943"
          select MCUX_COMPONENT_component.hal_clock.imx943

      endchoice
    endif

config MCUX_COMPONENT_component.hal_clock.imx943
    bool
    depends on MCUX_HW_BOARD_imx943evk

config MCUX_COMPONENT_component.hal_clock.imx95
    bool
    depends on MCUX_HW_BOARD_imx95lpd5evk19 || MCUX_HW_BOARD_imx95lp4xevk15 || MCUX_HW_BOARD_imx95verdinevk
```

## cmsis_drivers/cmsis_dspi/Kconfig
```kconfig
# Copyright 2024-2025 NXP
# SPDX-License-Identifier: Apache-2.0

config MCUX_HAS_COMPONENT_driver.cmsis_dspi
    bool
    default y if MCUX_HW_IP_DriverType_DSPI

config MCUX_COMPONENT_driver.cmsis_dspi
    bool "dspi"
    select MCUX_COMPONENT_driver.dspi_edma
    select MCUX_COMPONENT_CMSIS_Driver_Include.SPI
    select MCUX_COMPONENT_device.RTE
    depends on MCUX_HAS_COMPONENT_driver.cmsis_dspi
```

## cmsis_drivers/cmsis_ecspi/Kconfig
```kconfig
config MCUX_HAS_COMPONENT_driver.cmsis_ecspi
    bool
    default y if MCUX_HW_IP_DriverType_ECSPI

config MCUX_COMPONENT_driver.cmsis_ecspi
    bool "ecspi"
    select MCUX_COMPONENT_driver.ecspi
    select MCUX_COMPONENT_CMSIS_Driver_Include.SPI
    select MCUX_COMPONENT_device.RTE
    depends on MCUX_HAS_COMPONENT_driver.cmsis_ecspi
```

## cmsis_drivers/cmsis_flexcomm/Kconfig
```kconfig
config MCUX_HAS_COMPONENT_driver.cmsis_flexcomm_usart
    bool
    default y if MCUX_HW_IP_DriverType_FLEXCOMM_USART

config MCUX_COMPONENT_driver.cmsis_flexcomm_i2c
    bool "Use driver cmsis_flexcomm_i2c"
    select MCUX_COMPONENT_driver.flexcomm_i2c_dma
    select MCUX_COMPONENT_CMSIS_Driver_Include.I2C
    select MCUX_COMPONENT_device.RTE
    depends on MCUX_HAS_COMPONENT_driver.flexcomm_i2c_dma

config MCUX_COMPONENT_driver.cmsis_flexcomm_spi
    bool "Use driver cmsis_flexcomm_spi"
    select MCUX_COMPONENT_driver.flexcomm_spi_dma
    select MCUX_COMPONENT_CMSIS_Driver_Include.SPI
    select MCUX_COMPONENT_device.RTE
    depends on MCUX_HAS_COMPONENT_driver.flexcomm_spi_dma

config MCUX_COMPONENT_driver.cmsis_flexcomm_usart
    bool "Use driver cmsis_flexcomm_usart"
    select MCUX_COMPONENT_driver.flexcomm_usart_dma
    select MCUX_COMPONENT_CMSIS_Driver_Include.USART
    select MCUX_COMPONENT_device.RTE
    depends on MCUX_HAS_COMPONENT_driver.cmsis_flexcomm_usart
```

## cmsis_drivers/cmsis_i2c/Kconfig
```kconfig
config MCUX_HAS_COMPONENT_driver.cmsis_i2c
    bool
    default y if MCUX_HW_IP_DriverType_I2C

config MCUX_COMPONENT_driver.cmsis_i2c
    bool "i2c"
    select MCUX_COMPONENT_driver.i2c
    select MCUX_COMPONENT_CMSIS_Driver_Include.I2C
    select MCUX_COMPONENT_device.RTE
    depends on MCUX_HAS_COMPONENT_driver.cmsis_i2c
```

## cmsis_drivers/cmsis_ii2c/Kconfig
```kconfig
config MCUX_HAS_COMPONENT_driver.cmsis_ii2c
    bool
    default y if MCUX_HW_IP_DriverType_II2C

config MCUX_COMPONENT_driver.cmsis_ii2c
    bool "ii2c"
    select MCUX_COMPONENT_driver.ii2c
    select MCUX_COMPONENT_CMSIS_Driver_Include.I2C
    select MCUX_COMPONENT_device.RTE
    depends on MCUX_HAS_COMPONENT_driver.cmsis_ii2c
```

## cmsis_drivers/cmsis_iuart/Kconfig
```kconfig
# Copyright 2024-2025 NXP
# SPDX-License-Identifier: Apache-2.0

config MCUX_HAS_COMPONENT_driver.cmsis_iuart
    bool
    default y if MCUX_HW_IP_DriverType_IUART

config MCUX_COMPONENT_driver.cmsis_iuart
    bool "iuart"
    select MCUX_COMPONENT_driver.iuart
    select MCUX_COMPONENT_CMSIS_Driver_Include.USART
    select MCUX_COMPONENT_device.RTE
    depends on MCUX_HAS_COMPONENT_driver.cmsis_iuart
```

## cmsis_drivers/cmsis_lpc_gpio/Kconfig
```kconfig
config MCUX_COMPONENT_driver.cmsis_lpc_gpio
    bool "lpc_gpio"
    select MCUX_COMPONENT_driver.lpc_gpio
    select MCUX_COMPONENT_driver.pint
    select MCUX_COMPONENT_CMSIS_Driver_Include.GPIO
    select MCUX_COMPONENT_device.RTE
    depends on MCUX_HAS_COMPONENT_driver.lpc_gpio || MCUX_HAS_COMPONENT_driver.pint
```

## cmsis_drivers/cmsis_lpc_i2c/Kconfig
```kconfig
config MCUX_COMPONENT_driver.cmsis_lpc_i2c
    bool "lpc_i2c"
    select MCUX_COMPONENT_driver.lpc_i2c_dma
    select MCUX_COMPONENT_CMSIS_Driver_Include.I2C
    select MCUX_COMPONENT_device.RTE
    depends on MCUX_HAS_COMPONENT_driver.lpc_i2c_dma
```
