## expander/Kconfig
```kconfig
# Copyright 2024-2026 NXP
# SPDX-License-Identifier: BSD-3-Clause

config MCUX_DEPENDENCY_COMPONENT_component.use_i2c_dependency_options
    bool "Use i2c target interface to communicate with the host system"
    select MCUX_COMPONENT_driver.flexcomm_i2c if MCUX_HAS_COMPONENT_driver.flexcomm_i2c
    select MCUX_COMPONENT_driver.i2c if MCUX_HAS_COMPONENT_driver.i2c
    select MCUX_COMPONENT_driver.ii2c if MCUX_HAS_COMPONENT_driver.ii2c
    select MCUX_COMPONENT_driver.lpc_i2c if MCUX_HAS_COMPONENT_driver.lpc_i2c
    select MCUX_COMPONENT_driver.lpc_i2c_1 if MCUX_HAS_COMPONENT_driver.lpc_i2c_1
    select MCUX_COMPONENT_driver.lpflexcomm_lpi2c if MCUX_HAS_COMPONENT_driver.lpflexcomm_lpi2c
    select MCUX_COMPONENT_driver.lpi2c if MCUX_HAS_COMPONENT_driver.lpi2c

menuconfig MCUX_ABSTRACT_COMPONENT_component_expander
	bool "Expander drivers support"
    select MCUX_COMPONENT_driver.common
	select MCUX_DEPENDENCY_COMPONENT_component.use_i2c_dependency_options
	help
      Say yes here to select expander drivers.

if MCUX_ABSTRACT_COMPONENT_component_expander

config MCUX_COMPONENT_driver.pca6416a
    bool "Select expander pca6416a driver"
    help
      Say yes here to select pca6416a driver.

config MCUX_COMPONENT_driver.pcal6408
    bool "Select expander pcal6408 driver"
    help
      Say yes here to select pcal6408 driver.

config MCUX_COMPONENT_driver.pcal6524
    bool "Select expander pcal6524 driver"
    help
      Say yes here to select pcal6524 driver.

if MCUX_COMPONENT_driver.pcal6524

config PCAL6524_CALLBACK_PER_PIN
    bool "Use per-pin interrupt callbacks"
    default y
    help
      When enabled (default), the PCAL6524 handle stores one callback per I/O
      pin and PCAL6524_InterruptHandler dispatches per-pin callbacks
      automatically. When disabled, a single global callback receives the
      whole interrupt-source bitmask and the user does any per-pin dispatch
      manually.

      Per-pin mode adds 24 * 2 pointers (192 bytes on 32-bit ARM) to each
      handle; disable it if memory is constrained and a single callback is
      sufficient.

endif

config MCUX_COMPONENT_driver.adp5585
    bool "Select expander adp5585 driver"
    help
      Say yes here to select adp5585 driver.

config MCUX_COMPONENT_driver.pi4io6408
    bool "Select expander pi4io6408 driver"
    help
      Say yes here to select pi4io6408 driver.

endif
```

## extern_flash/Kconfig
```kconfig
# Copyright 2024 NXP
# SPDX-License-Identifier: BSD-3-Clause

config MCUX_COMPONENT_component.eeprom_AT45DBxxxx
    bool "eeprom_AT45DBxxxx"
    default n
    help
        Enable component.eeprom_AT45DBxxxx component
    select MCUX_COMPONENT_component.spi_adapter
    select MCUX_COMPONENT_component.gpio_adapter
	depends on MCUX_HW_BOARD_frdmkw38


config MCUX_COMPONENT_component.eeprom_InternalFlash
    bool "eeprom_InternalFlash"
    default n
    help
        Enable component.eeprom_InternalFlash component
    select MCUX_COMPONENT_component.flash_adapter
    depends on MCUX_HW_BOARD_frdmkw38


config MCUX_COMPONENT_component.eeprom_AT25Fxxxx
    bool "eeprom_AT25Fxxxx"
    default n
    help
        Enable component.eeprom_AT25Fxxxx component
    select MCUX_COMPONENT_component.spi_adapter
    depends on MCUX_HW_BOARD_frdmkw38
```

## format/Kconfig
```kconfig
# Copyright 2024 NXP
# SPDX-License-Identifier: BSD-3-Clause

config MCUX_COMPONENT_utility.format
    bool "format"
    if MCUX_COMPONENT_utility.format
    endif
```

## genHal/_boards/frdmrw612/Kconfig
```kconfig
config LITTLE_ENDIAN
    bool
    default y
    select CLOCK_CONTROL
config DT_HAS_NXP_IMX_FLEXSPI_ENABLED
    bool
    default y
config DT_HAS_NXP_LPC_SYSCON_ENABLED
    bool
    default y
config DT_HAS_NXP_MCI_IO_MUX_ENABLED
    bool
    default y
config DT_HAS_NXP_IMX_FLEXSPI_NOR_ENABLED
    bool
    default y

config ARCH_SUPPORTS_COREDUMP
    bool
    default y
```

## genHal/memc/Kconfig
```kconfig
config MCUX_COMPONENT_component.genHal.memc
	bool "Memory controller drivers [EXPERIMENTAL]"
	default n
	select MCUX_COMPONENT_component.genHal.pinctrl
	select MCUX_COMPONENT_component.zephyr_header.drv_memc



config MCUX_COMPONENT_component.genHal.memc.flexspi
	bool
	default y if MCUX_COMPONENT_component.genHal.memc












menuconfig MEMC
	bool
	select EXPERIMENTAL
	default y if MCUX_COMPONENT_component.genHal.memc
	help
	  Add support for memory controllers


if MEMC

config MEMC_INIT_PRIORITY
	int "Initialization priority"
	default 0
	help
	  Memory controllers initialization priority.

rsource "Kconfig.mcux"

endif
```

## genHal/pinctrl/Kconfig
```kconfig
config MCUX_COMPONENT_component.genHal.pinctrl
	bool "Pin controller drivers"
	default n
	select MCUX_COMPONENT_component.zephyr_header.drv_pinctrl



config MCUX_COMPONENT_component.genHal.pinctrl.mci_io_mux
	bool
	default y if DT_HAS_NXP_MCI_IO_MUX_ENABLED && MCUX_COMPONENT_component.genHal.pinctrl



menuconfig PINCTRL
	bool 
	default y if MCUX_COMPONENT_component.genHal.pinctrl

if PINCTRL

module = PINCTRL
module-str = PINCTRL
# source "subsys/logging/Kconfig.template.log_config"

config PINCTRL_STORE_REG
	bool
	help
	  This option must be selected by drivers that require access to the device
	  register address. This can happen, for example, if certain pin control
	  actions are device dependent or require access to device specific
	  registers

config PINCTRL_NON_STATIC
	bool
	help
	  This option can be selected if the pin control configuration defined by
	  a driver has to be accessed externally. This can happen, for example, when
	  dynamic pin control is enabled or in testing environments.

config PINCTRL_DYNAMIC
	bool "Dynamic configuration of pins"
	select PINCTRL_NON_STATIC
	help
	  When this option is enabled pin control configuration can be changed at
	  runtime. This can be useful, for example, to change the pins assigned to a
	  peripheral at early boot stages depending on a certain input.

rsource "Kconfig.mci_io_mux"

endif  # PINCTRL
```

## gen_hal/Kconfig
```kconfig
# Copyright 2025 NXP
# SPDX-License-Identifier: BSD-3-Clause

config MCUX_COMPONENT_component.zephyr_headers
	bool "Zephyr Headers"
	help
	  Zephyr Headers Adapted to the SDK Environment

menuconfig MCUX_COMPONENT_component.gen_hal
    bool "Generic HAL"
	select MCUX_COMPONENT_component.zephyr_headers
    help
      Generic HAL based on Zephyr

	if MCUX_COMPONENT_component.gen_hal
		rsource "zephyr/drivers/flash/Kconfig"
		rsource "zephyr/drivers/memc/Kconfig"
		rsource "zephyr/drivers/pinctrl/Kconfig"
		rsource "zephyr/drivers/clock_control/Kconfig"
		osource "components/gen_hal/_boards/${board}/Kconfig"
		osource "components/gen_hal/devices/${soc_portfolio}/${soc_series}/Kconfig"
	endif

	if MCUX_COMPONENT_component.zephyr_headers
		rsource "Kconfig.map"
		rsource "Kconfig.zephyr_headers"
	endif

config MCUX_COMPONENT_component.gen_hal.osa
	bool "OSA to support Zephyr Kernel related features"
	select MCUX_COMPONENT_component.zephyr_headers.kernel
	help
		OSA to support Zephyr kernel features such as thread.
```
