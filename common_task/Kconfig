## common_task/Kconfig
```kconfig
# Copyright 2024 NXP
# SPDX-License-Identifier: BSD-3-Clause

config MCUX_COMPONENT_component.common_task
    bool "common_task"
    default n
    help
        Enable component.common_task component
    select MCUX_COMPONENT_component.osa
```

## conn_fwloader/Kconfig
```kconfig
# Copyright 2024-2026 NXP
# SPDX-License-Identifier: BSD-3-Clause

menu "connectivity firmware loader / libraries select"
    config MCUX_COMPONENT_driver.conn_fwloader
        bool "conn_fwloader"
        select MCUX_COMPONENT_driver.ocotp_rw61x
        select MCUX_COMPONENT_component.osa
        imply MCUX_COMPONENT_component.mflash_offchip

    config MCUX_COMPONENT_driver.conn_fwloader.fw_bin
        bool "Firmware Binary"
        default y if MCUX_COMPONENT_driver.conn_fwloader
        select MCUX_COMPONENT_component.wifi_bt_module.config

    config MCUX_COMPONENT_driver.conn_fwloader_ns
        bool "conn_fwloader_ns"

    config MCUX_COMPONENT_driver.conn_fwloader.monolithic
        bool "Monolithic application"
        help
            Enable the monolithic property. This will embedd
            the CPU1/CPU2 FW in the main application.

    if MCUX_COMPONENT_driver.conn_fwloader.monolithic

    config MONOLITHIC_WIFI
        bool "Wi-Fi"
        help
            Enable monolithic property for WIFI.

    config MONOLITHIC_BLE
        bool "BLE"
        help
            Enable monolithic property for BLE.

    config MONOLITHIC_BLE_15_4
        bool "BLE/15.4 combo"
        help
            Enable monolithic property for BLE+15.4 combo.

    endif # MCUX_COMPONENT_driver.conn_fwloader.monolithic

    config MCUX_COMPONENT_driver.wifi.libcsi
        bool "Wi-Fi libcsi"
        select MCUX_COMPONENT_middleware.wifi
        select MCUX_COMPONENT_middleware.wifi.wifidriver
        select MCUX_COMPONENT_middleware.wifi.libcsi.incl
        help
            Wi-Fi libcsi

    if MCUX_COMPONENT_driver.wifi.libcsi
        choice
        prompt "Select libcsi"
        default MCUX_COMPONENT_driver.wifi.libcsi_cm33 \
            if MCUX_COMPONENT_component.wifi_bt_module.RW61X
        default MCUX_COMPONENT_driver.wifi.libcsi_cm7.cm7f_sta_20M_only \
            if MCUX_COMPONENT_component.wifi_bt_module.board_murata_2ll_m2 || \
               MCUX_COMPONENT_component.wifi_bt_module.board_murata_2ll_usd
        default MCUX_COMPONENT_driver.wifi.libcsi_cm7.cm7f
        help
            Choose the Wi-Fi CSI library.

        config MCUX_COMPONENT_driver.wifi.libcsi_cm33
            bool "libcsi for Cortex-M33"

        config MCUX_COMPONENT_driver.wifi.libcsi_cm7.cm7f
            bool "libcsi for Cortex-M7 (CM7F)"

        config MCUX_COMPONENT_driver.wifi.libcsi_cm7.cm7f_sta_20M_only
            bool "libcsi for Cortex-M7 (CM7F) (STA 20MHz only)"

        endchoice
    endif

    config FLASH_IPED
        bool "flash IPED enabled"
        default n
        depends on MCUX_COMPONENT_component.wifi_bt_module.RW61X
        help
            Flash IPED feature enabled.

endmenu
```

## coremark/Kconfig
```kconfig
# Copyright 2025 NXP
# SPDX-License-Identifier: BSD-3-Clause

config MCUX_COMPONENT_component.coremark
    bool "coremark_workload"
    default n
    help
        Enable component.coremark component
```

## crc/Kconfig
```kconfig
# Copyright 2024 NXP
# SPDX-License-Identifier: BSD-3-Clause

config MCUX_COMPONENT_component.crc_adapter
    bool "Enable component.crc_adapter"
    default n
    help
        Enable component.crc_adapter component
    select MCUX_COMPONENT_driver.crc
    depends on MCUX_HAS_COMPONENT_driver.crc
    
    
config MCUX_COMPONENT_component.lpc_crc_adapter
    bool "Enable component.lpc_crc_adapter"
    default n
    help
        Enable component.lpc_crc_adapter component
    select MCUX_COMPONENT_driver.lpc_crc
    depends on MCUX_HAS_COMPONENT_driver.lpc_crc
    
    
config MCUX_COMPONENT_component.software_crc_adapter
    bool "Enable component.software_crc_adapter"
    default n
    help
        Enable component.software_crc_adapter component
    
```

## debug/Kconfig
```kconfig
# Copyright 2025 NXP
# SPDX-License-Identifier: BSD-3-Clause

rsource "coredump/Kconfig.mcux"
rsource "memfault/Kconfig"
```

## debug/memfault/Kconfig
```kconfig
# Copyright 2024-2025 NXP
# SPDX-License-Identifier: BSD-3-Clause

menuconfig MCUX_COMPONENT_component.memfault_sdk
    bool "MemFault SDK"

    if MCUX_COMPONENT_component.memfault_sdk

    config MCUX_COMPONENT_component.memfault_sdk.http
        bool "http"

    config MCUX_COMPONENT_component.memfault_sdk.metrics
        bool "metrics"
        default y

    config MCUX_COMPONENT_component.memfault_sdk.ports.freertos
        bool "FreeRTOS port"

    config MCUX_COMPONENT_component.memfault_sdk.ports.mcuxsdk
        bool "NXP MCUXSDK Port"
        default y

        if MCUX_COMPONENT_component.memfault_sdk.ports.mcuxsdk

        config MEMFAULT_DEVICE_SERIAL
            string "Device Serial"
            default "\"NXP_MCU\""
            help
              Device serial in show in device info.
              Regular expression defining valid device serials: ^[-a-zA-Z0-9_]+$

        config MEMFAULT_SW_TYPE
            string "Firmware Name"
            default "\"app-fw\""
            help
              A name to represent the firmware running on the MCU.
              (i.e "ble-fw", "main-fw", or a codename for your project)

        config MEMFAULT_SW_VERSION
            string "Firmware Version"
            default "\"1.0.0\""

        config MEMFAULT_HW_VERSION
            string "Hardware Version"
            default "\"dvt1\""
            help
              The revision of hardware for the device. This value must remain
              the same for a unique device.
              (i.e evt, dvt, pvt, or rev1, rev2, etc)
              Regular expression defining valid hardware versions: ^[-a-zA-Z0-9_\.\+]+$

        config MEMFAULT_FLASH_SUPPORT_PAGE_REPROGRAM
            bool "Flash support reprogram page"
            default y
            help
              After the page is erased, the page can be reprogramed to update
              the empty region.

        config MEMFAULT_FLASH_BASE_OFFSET
            hex "Backend flash offset"
            default 0x001F8000
            help
              Offset of the backend flash used for memfault in whole flash

        config MEMFAULT_FLASH_SIZE
            hex "Backend flash size"
            default 0x00008000
            help
              Memfault backend flash size

        endif

    endif
```
