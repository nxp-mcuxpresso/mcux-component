## slcd_engine/Kconfig
```kconfig
# Copyright 2024 NXP
# SPDX-License-Identifier: BSD-3-Clause

menuconfig MCUX_COMPONENT_driver.slcd_engine
    bool "slcd_engine"
    if MCUX_COMPONENT_driver.slcd_engine
      choice
        prompt "SLCD selection"
        config MCUX_COMPONENT_driver.slcd_gdh_1247wp
          bool "GDH_1247WP"
        config MCUX_COMPONENT_driver.slcd_lcd_s401m16kr
          bool "LCD S401M16KR"
      endchoice
    endif
```

## sm/Kconfig
```kconfig
# Copyright 2024-2025 NXP
#
# SPDX-License-Identifier: BSD-3-Clause

menu "System Manager (SM)"

config MCUX_COMPONENT_component.sm_clock
    bool "clock"
    select MCUX_COMPONENT_component.sm.crc
    select MCUX_COMPONENT_component.sm.scmi
    select MCUX_COMPONENT_component.sm.smt

    if MCUX_COMPONENT_component.sm_clock
      choice
        prompt "porting layers"
        default MCUX_DEPENDENCY_COMPONENT_component.sm_clock_DEPEND_ANYOF_OPTION_1

        config MCUX_DEPENDENCY_COMPONENT_component.sm_clock_DEPEND_ANYOF_OPTION_1
          bool "imx95_cm33"
          select MCUX_COMPONENT_component.sm.imx95_cm33

        config MCUX_DEPENDENCY_COMPONENT_component.sm_clock_DEPEND_ANYOF_OPTION_2
          bool "imx95_cm7"
          select MCUX_COMPONENT_component.sm.imx95_cm7

        config MCUX_DEPENDENCY_COMPONENT_component.sm_clock_DEPEND_ANYOF_OPTION_7
          bool "imx95_ca55"
          select MCUX_COMPONENT_component.sm.imx95_ca55

        config MCUX_DEPENDENCY_COMPONENT_component.sm_clock_DEPEND_ANYOF_OPTION_3
          bool "imx943_cm33_core0"
          select MCUX_COMPONENT_component.sm.imx943_cm33_core0

        config MCUX_DEPENDENCY_COMPONENT_component.sm_clock_DEPEND_ANYOF_OPTION_4
          bool "imx943_cm33_core1"
          select MCUX_COMPONENT_component.sm.imx943_cm33_core1

        config MCUX_DEPENDENCY_COMPONENT_component.sm_clock_DEPEND_ANYOF_OPTION_5
          bool "imx943_cm7_core0"
          select MCUX_COMPONENT_component.sm.imx943_cm7_core0

        config MCUX_DEPENDENCY_COMPONENT_component.sm_clock_DEPEND_ANYOF_OPTION_6
          bool "imx943_cm7_core1"
          select MCUX_COMPONENT_component.sm.imx943_cm7_core1

      endchoice
    endif

config MCUX_COMPONENT_component.sm_pinctrl
    bool "pinctrl"
    select MCUX_COMPONENT_component.sm.crc
    select MCUX_COMPONENT_component.sm.scmi
    select MCUX_COMPONENT_component.sm.smt

    if MCUX_COMPONENT_component.sm_pinctrl
      choice
        prompt "porting layers"
        default MCUX_DEPENDENCY_COMPONENT_component.sm_pinctrl_DEPEND_ANYOF_OPTION_1

        config MCUX_DEPENDENCY_COMPONENT_component.sm_pinctrl_DEPEND_ANYOF_OPTION_1
          bool "imx95_cm33"
          select MCUX_COMPONENT_component.sm.imx95_cm33

        config MCUX_DEPENDENCY_COMPONENT_component.sm_pinctrl_DEPEND_ANYOF_OPTION_2
          bool "imx95_cm7"
          select MCUX_COMPONENT_component.sm.imx95_cm7

        config MCUX_DEPENDENCY_COMPONENT_component.sm_pinctrl_DEPEND_ANYOF_OPTION_7
          bool "imx95_ca55"
          select MCUX_COMPONENT_component.sm.imx95_ca55

        config MCUX_DEPENDENCY_COMPONENT_component.sm_pinctrl_DEPEND_ANYOF_OPTION_3
          bool "imx943_cm33_core0"
          select MCUX_COMPONENT_component.sm.imx943_cm33_core0

        config MCUX_DEPENDENCY_COMPONENT_component.sm_pinctrl_DEPEND_ANYOF_OPTION_4
          bool "imx943_cm33_core1"
          select MCUX_COMPONENT_component.sm.imx943_cm33_core1

        config MCUX_DEPENDENCY_COMPONENT_component.sm_pinctrl_DEPEND_ANYOF_OPTION_5
          bool "imx943_cm7_core0"
          select MCUX_COMPONENT_component.sm.imx943_cm7_core0

        config MCUX_DEPENDENCY_COMPONENT_component.sm_pinctrl_DEPEND_ANYOF_OPTION_6
          bool "imx943_cm7_core1"
          select MCUX_COMPONENT_component.sm.imx943_cm7_core1

      endchoice
    endif

config MCUX_COMPONENT_component.sm_power
    bool "power"
    select MCUX_COMPONENT_component.sm.crc
    select MCUX_COMPONENT_component.sm.scmi
    select MCUX_COMPONENT_component.sm.smt

    if MCUX_COMPONENT_component.sm_power
      choice
        prompt "porting layers"
        default MCUX_DEPENDENCY_COMPONENT_component.sm_power_DEPEND_ANYOF_OPTION_1

        config MCUX_DEPENDENCY_COMPONENT_component.sm_power_DEPEND_ANYOF_OPTION_1
          bool "imx95_cm33"
          select MCUX_COMPONENT_component.sm.imx95_cm33

        config MCUX_DEPENDENCY_COMPONENT_component.sm_power_DEPEND_ANYOF_OPTION_2
          bool "imx95_cm7"
          select MCUX_COMPONENT_component.sm.imx95_cm7

        config MCUX_DEPENDENCY_COMPONENT_component.sm_power_DEPEND_ANYOF_OPTION_7
          bool "imx95_ca55"
          select MCUX_COMPONENT_component.sm.imx95_ca55

        config MCUX_DEPENDENCY_COMPONENT_component.sm_power_DEPEND_ANYOF_OPTION_3
          bool "imx943_cm33_core0"
          select MCUX_COMPONENT_component.sm.imx943_cm33_core0

        config MCUX_DEPENDENCY_COMPONENT_component.sm_power_DEPEND_ANYOF_OPTION_4
          bool "imx943_cm33_core1"
          select MCUX_COMPONENT_component.sm.imx943_cm33_core1

        config MCUX_DEPENDENCY_COMPONENT_component.sm_power_DEPEND_ANYOF_OPTION_5
          bool "imx943_cm7_core0"
          select MCUX_COMPONENT_component.sm.imx943_cm7_core0

        config MCUX_DEPENDENCY_COMPONENT_component.sm_power_DEPEND_ANYOF_OPTION_6
          bool "imx943_cm7_core1"
          select MCUX_COMPONENT_component.sm.imx943_cm7_core1

      endchoice
    endif

config MCUX_COMPONENT_component.sm_reset
    bool "reset"
    select MCUX_COMPONENT_component.sm.crc
    select MCUX_COMPONENT_component.sm.scmi
    select MCUX_COMPONENT_component.sm.smt

    if MCUX_COMPONENT_component.sm_reset
      choice
        prompt "porting layers"
        default MCUX_DEPENDENCY_COMPONENT_component.sm_reset_DEPEND_ANYOF_OPTION_2

        config MCUX_DEPENDENCY_COMPONENT_component.sm_reset_DEPEND_ANYOF_OPTION_1
          bool "imx943_cm33_core0"
          select MCUX_COMPONENT_component.sm.imx943_cm33_core0

        config MCUX_DEPENDENCY_COMPONENT_component.sm_reset_DEPEND_ANYOF_OPTION_2
          bool "imx943_cm33_core1"
          select MCUX_COMPONENT_component.sm.imx943_cm33_core1

        config MCUX_DEPENDENCY_COMPONENT_component.sm_reset_DEPEND_ANYOF_OPTION_3
          bool "imx943_cm7_core0"
          select MCUX_COMPONENT_component.sm.imx943_cm7_core0

        config MCUX_DEPENDENCY_COMPONENT_component.sm_reset_DEPEND_ANYOF_OPTION_4
          bool "imx943_cm7_core1"
          select MCUX_COMPONENT_component.sm.imx943_cm7_core1

      endchoice
    endif

config MCUX_COMPONENT_component.sm.imx943_cm33_core0
    bool
    select MCUX_COMPONENT_driver.mu1
    select MCUX_COMPONENT_component.sm.smt
    select MCUX_COMPONENT_component.sm.crc
    select MCUX_COMPONENT_component.sm.scmi
    depends on MCUX_HW_BOARD_imx943evk

config MCUX_COMPONENT_component.sm.imx943_cm33_core1
    bool
    select MCUX_COMPONENT_driver.mu1
    select MCUX_COMPONENT_component.sm.smt
    select MCUX_COMPONENT_component.sm.crc
    select MCUX_COMPONENT_component.sm.scmi
    depends on MCUX_HW_BOARD_imx943evk

config MCUX_COMPONENT_component.sm.imx943_cm7_core0
    bool
    select MCUX_COMPONENT_driver.mu1
    select MCUX_COMPONENT_component.sm.smt
    select MCUX_COMPONENT_component.sm.crc
    select MCUX_COMPONENT_component.sm.scmi
    depends on MCUX_HW_BOARD_imx943evk

config MCUX_COMPONENT_component.sm.imx943_cm7_core1
    bool
    select MCUX_COMPONENT_driver.mu1
    select MCUX_COMPONENT_component.sm.smt
    select MCUX_COMPONENT_component.sm.crc
    select MCUX_COMPONENT_component.sm.scmi
    depends on MCUX_HW_BOARD_imx943evk

config MCUX_COMPONENT_component.sm.imx95_cm33
    bool
    select MCUX_COMPONENT_driver.mu1
    select MCUX_COMPONENT_component.sm.smt
    select MCUX_COMPONENT_component.sm.crc
    select MCUX_COMPONENT_component.sm.scmi
    depends on MCUX_HW_BOARD_imx95lpd5evk19 || MCUX_HW_BOARD_imx95lp4xevk15 || MCUX_HW_BOARD_imx95verdinevk

config MCUX_COMPONENT_component.sm.imx95_cm7
    bool
    select MCUX_COMPONENT_driver.mu1
    select MCUX_COMPONENT_component.sm.smt
    select MCUX_COMPONENT_component.sm.crc
    select MCUX_COMPONENT_component.sm.scmi
    depends on MCUX_HW_BOARD_imx95lpd5evk19 || MCUX_HW_BOARD_imx95lp4xevk15 || MCUX_HW_BOARD_imx95verdinevk

config MCUX_COMPONENT_component.sm.imx95_ca55
    bool
    select MCUX_COMPONENT_driver.mu1
    select MCUX_COMPONENT_component.sm.smt
    select MCUX_COMPONENT_component.sm.crc
    select MCUX_COMPONENT_component.sm.scmi

endmenu
```

## smbus/Kconfig
```kconfig
# Copyright 2024-2025 NXP
# SPDX-License-Identifier: BSD-3-Clause

menuconfig MCUX_COMPONENT_component.smbus
    bool "smbus"
    select MCUX_COMPONENT_component.smbus.port_pn_i2c

if MCUX_COMPONENT_component.smbus
    config MCUX_COMPONENT_component.smbus_event
        bool "event"
        select MCUX_COMPONENT_component.osa

    config MCUX_COMPONENT_component.smbus.port_pn_i2c
        bool "port pn i2c"
        select MCUX_COMPONENT_driver.i2c_gpdma
        select MCUX_COMPONENT_driver.i2c
        select MCUX_COMPONENT_driver.gpdma
        select MCUX_COMPONENT_component.smbus_event
endif
```

## smt/Kconfig
```kconfig
# Copyright 2024 NXP
# SPDX-License-Identifier: BSD-3-Clause

config MCUX_COMPONENT_component.sm.smt
    bool "sm.smt"
    default n
    help
	Enable component.sm.smt component
```

## spi/Kconfig
```kconfig
# Copyright 2024 NXP
# SPDX-License-Identifier: BSD-3-Clause

config MCUX_COMPONENT_component.spi_adapter
    bool "Use spi adapter"
    select MCUX_COMPONENT_driver.spi
    select MCUX_COMPONENT_driver.common
    depends on MCUX_HAS_COMPONENT_driver.spi

    if MCUX_COMPONENT_component.spi_adapter
        # config DRIVER_spi_ADAPTER_CONFIG_DEMO1
        #     bool "Driver spi_ADAPTER config demo 1"

        # config DRIVER_spi_ADAPTER_CONFIG_DEMO2
        #     bool "Driver spi_ADAPTER config demo 2"
    endif



config MCUX_COMPONENT_component.dspi_adapter
    bool "Use dspi adapter"
    select MCUX_COMPONENT_driver.dspi
    select MCUX_COMPONENT_driver.common
    depends on MCUX_HAS_COMPONENT_driver.dspi
    if MCUX_COMPONENT_component.dspi_adapter
        # config DRIVER_dspi_ADAPTER_CONFIG_DEMO1
        #     bool "Driver dspi_ADAPTER config demo 1"

        # config DRIVER_dspi_ADAPTER_CONFIG_DEMO2
        #     bool "Driver dspi_ADAPTER config demo 2"
    endif



config MCUX_COMPONENT_component.lpspi_adapter
    bool "Use lpspi adapter"
    select MCUX_COMPONENT_driver.lpspi
    select MCUX_COMPONENT_driver.common
    depends on MCUX_HAS_COMPONENT_driver.lpspi
    if MCUX_COMPONENT_component.lpspi_adapter
        # config DRIVER_lpspi_ADAPTER_CONFIG_DEMO1
        #     bool "Driver lpspi_ADAPTER config demo 1"

        # config DRIVER_lpspi_ADAPTER_CONFIG_DEMO2
        #     bool "Driver lpspi_ADAPTER config demo 2"
    endif



config MCUX_COMPONENT_component.flexcomm_spi_adapter
    bool "Use flexcomm_spi adapter"
    select MCUX_COMPONENT_driver.flexcomm_spi
    select MCUX_COMPONENT_driver.common
    depends on MCUX_HAS_COMPONENT_driver.flexcomm_spi
    if MCUX_COMPONENT_component.flexcomm_spi_adapter
        # config DRIVER_flexcomm_spi_ADAPTER_CONFIG_DEMO1
        #     bool "Driver flexcomm_spi_ADAPTER config demo 1"

        # config DRIVER_flexcomm_spi_ADAPTER_CONFIG_DEMO2
        #     bool "Driver flexcomm_spi_ADAPTER config demo 2"
    endif
```

## srtm/Kconfig
```kconfig
# Copyright 2024-2025 NXP
# SPDX-License-Identifier: BSD-3-Clause

menuconfig MCUX_COMPONENT_driver.srtm
    bool "srtm"
    default n
    select MCUX_COMPONENT_driver.srtm.freertos
    select MCUX_COMPONENT_middleware.multicore.rpmsg-lite
    select MCUX_COMPONENT_middleware.multicore.rpmsg-lite.ns
    help
        SRTM (Simplified Real Time Message) Application Protocol

if MCUX_COMPONENT_driver.srtm
    rsource "channels/Kconfig"

    menu "Services"
        rsource "services/Kconfig"
    endmenu

    config MCUX_COMPONENT_driver.srtm.freertos
        bool "SRTM FreeRTOS"
endif
```

## srtm/channels/Kconfig
```kconfig
# Copyright 2024-2025 NXP
# SPDX-License-Identifier: BSD-3-Clause


choice
    prompt "Endpoints"
    default MCUX_COMPONENT_component.rpmsg_endpoint
    depends on MCUX_COMPONENT_driver.srtm

    config MCUX_COMPONENT_component.rpmsg_endpoint
        bool "RPMSG"

    config MCUX_COMPONENT_component.rpmsg_emu_endpoint
        bool "RPMSG Emulate"

    config MCUX_COMPONENT_component.mu_endpoint
        bool "MU"

endchoice
```
