## timer_manager/Kconfig
```kconfig
# Copyright 2024 NXP
# SPDX-License-Identifier: BSD-3-Clause

config MCUX_COMPONENT_component.timer_manager
    bool "Enable component.timer_manager"
    default n
    help
        Enable component.timer_manager component
    select MCUX_COMPONENT_driver.common
    select MCUX_COMPONENT_component.lists

    if MCUX_COMPONENT_component.timer_manager
        choice MCUX_DEPENDENCY_COMPONENT_component.timer_manager_DEPEND_component.timer.selection
            prompt "component.timer_manager anyof dependency"
            default MCUX_DEPENDENCY_COMPONENT_component.timer_manager_DEPEND_component.timer_manager_lptmr
            config MCUX_DEPENDENCY_COMPONENT_component.timer_manager_DEPEND_component.timer_manager_ctimer
                bool "Select component.ctimer_adapter"
                select MCUX_COMPONENT_component.ctimer_adapter
                depends on MCUX_HAS_COMPONENT_driver.ctimer
            config MCUX_DEPENDENCY_COMPONENT_component.timer_manager_DEPEND_component.timer_manager_ftm
                bool "Select timer_manager component.ftm_adapter"
                select MCUX_COMPONENT_component.ftm_adapter
                depends on MCUX_HAS_COMPONENT_driver.ftm
            config MCUX_DEPENDENCY_COMPONENT_component.timer_manager_DEPEND_component.timer_manager_gpt
                bool "Select timer_manager component.gpt_adapter"
                select MCUX_COMPONENT_component.gpt_adapter
                depends on MCUX_HAS_COMPONENT_driver.gpt
            config MCUX_DEPENDENCY_COMPONENT_component.timer_manager_DEPEND_component.timer_manager_lpit
                bool "Select timer_manager component.lpit_adapter"
                select MCUX_COMPONENT_component.lpit_adapter
                depends on MCUX_HAS_COMPONENT_driver.lpit
            config MCUX_DEPENDENCY_COMPONENT_component.timer_manager_DEPEND_component.timer_manager_lptmr
                bool "Select timer_manager component.lptmr_adapter"
                select MCUX_COMPONENT_component.lptmr_adapter
                depends on MCUX_HAS_COMPONENT_driver.lptmr
            config MCUX_DEPENDENCY_COMPONENT_component.timer_manager_DEPEND_component.timer_manager_mrt
                bool "Select timer_manager component.mrt_adapter"
                select MCUX_COMPONENT_component.mrt_adapter
                depends on MCUX_HAS_COMPONENT_driver.mrt
            config MCUX_DEPENDENCY_COMPONENT_component.timer_manager_DEPEND_component.timer_manager_pit
                bool "Select timer_manager component.pit_adapter"
                select MCUX_COMPONENT_component.pit_adapter
                depends on MCUX_HAS_COMPONENT_driver.pit
            config MCUX_DEPENDENCY_COMPONENT_component.timer_manager_DEPEND_component.timer_manager_tpm
                bool "Select timer_manager component.tpm_adapter"
                select MCUX_COMPONENT_component.tpm_adapter
                depends on MCUX_HAS_COMPONENT_driver.tpm
            config MCUX_DEPENDENCY_COMPONENT_component.timer_manager_DEPEND_component.timer_manager_dsc_pit
                bool "Select timer_manager component.dsc_pit_adapter"
                select MCUX_COMPONENT_component.dsc_pit_adapter
                depends on MCUX_HAS_COMPONENT_driver.dsc_pit
            config MCUX_DEPENDENCY_COMPONENT_component.timer_manager_DEPEND_component.timer_manager_ostimer
                bool "Select timer_manager component.ostimer_adapter"
                select MCUX_COMPONENT_component.ostimer_adapter
                depends on MCUX_HAS_COMPONENT_driver.ostimer
        endchoice
    endif
    
config MCUX_PRJSEG_configure.timer_manager_enable_time_stamp
    bool "Use timer manager enable timestamp"
    depends on MCUX_COMPONENT_component.timer_manager
    help
        If need use timer manager time stamp, please define set CONFIG_MCUX_PRJSEG_configure.timer_manager_enable_time_stamp=y in prj.conf,
    if MCUX_PRJSEG_configure.timer_manager_enable_time_stamp
        choice MCUX_DEPENDENCY_SETTING_component.timer_manager_DEPEND_component.timer_stamp.selection
            prompt "component.timer_manager_enable_time_stamp anyof dependency"
            default MCUX_DEPENDENCY_SETTING_component.timer_manager_DEPEND_component.timer_stamp_lptmr
            config MCUX_DEPENDENCY_SETTING_component.timer_manager_DEPEND_component.timer_stamp_ctimer
                bool "Select component.ctimer_time_stamp_adapter"
                select MCUX_COMPONENT_component.ctimer_time_stamp_adapter
                depends on MCUX_HAS_COMPONENT_driver.ctimer
            config MCUX_DEPENDENCY_SETTING_component.timer_manager_DEPEND_component.timer_stamp_gpt
                bool "Select timer_manager component.gpt_time_stamp_adapter"
                select MCUX_COMPONENT_component.gpt_time_stamp_adapter
                depends on MCUX_HAS_COMPONENT_driver.gpt
            config MCUX_DEPENDENCY_SETTING_component.timer_manager_DEPEND_component.timer_stamp_lpit
                bool "Select timer_manager component.lpit_time_stamp_adapter"
                select MCUX_COMPONENT_component.lpit_time_stamp_adapter
                depends on MCUX_HAS_COMPONENT_driver.lpit
            config MCUX_DEPENDENCY_SETTING_component.timer_manager_DEPEND_component.timer_stamp_lptmr
                bool "Select timer_manager component.lptmr_time_stamp_adapter"
                select MCUX_COMPONENT_component.lptmr_time_stamp_adapter
                depends on MCUX_HAS_COMPONENT_driver.lptmr
            config MCUX_DEPENDENCY_SETTING_component.timer_manager_DEPEND_component.timer_stamp_pit
                bool "Select timer_manager component.pit_time_stamp_adapter"
                select MCUX_COMPONENT_component.pit_time_stamp_adapter
                depends on MCUX_HAS_COMPONENT_driver.pit
            config MCUX_DEPENDENCY_SETTING_component.timer_manager_DEPEND_component.timer_stamp_ostimer
                bool "Select timer_manager component.ostimer_time_stamp_adapter"
                select MCUX_COMPONENT_component.ostimer_time_stamp_adapter
                depends on MCUX_HAS_COMPONENT_driver.ostimer
        endchoice
    endif
```

## touch/Kconfig
```kconfig
# Copyright 2024 NXP
# SPDX-License-Identifier: BSD-3-Clause

menu "Touch panel driver"

config MCUX_COMPONENT_driver.gt911
    bool "Enable driver for touch panel gt911"
    default n
    help
        Enable driver for touch panel gt911 component

config MCUX_COMPONENT_driver.ft6x06
    bool "Enable driver for touch panel ft6x06"
    default n
    help
        Enable driver for touch panel ft6x06 component
    select MCUX_COMPONENT_CMSIS_Driver_Include.I2C

config MCUX_COMPONENT_driver.ft3267
    bool "Enable driver for touch panel ft3267"
    default n
    help
        Enable driver for touch panel ft3267 component

config MCUX_COMPONENT_driver.ektf2k
    bool "Enable driver for touch panel ektf2k"
    default n
    help
        Enable driver for touch panel ektf2k component

config MCUX_COMPONENT_driver.ft5406
    bool "Enable driver for touch panel ft5406"
    default n
    help
        Enable driver for touch panel ft5406 component

config MCUX_COMPONENT_driver.ft5406_rt
    bool "Enable driver for touch panel ft5406_rt"
    default n
    help
        Enable driver for touch panel ft5406_rt component
    select MCUX_COMPONENT_driver.lpi2c if MCUX_HAS_COMPONENT_driver.lpi2c
    select MCUX_COMPONENT_driver.lpflexcomm_lpi2c if MCUX_HAS_COMPONENT_driver.lpflexcomm_lpi2c

config MCUX_COMPONENT_driver.tma525b
    bool "Enable driver for touch panel tma525b"
    default n
    help
        Enable driver for touch panel tma525b component

endmenu
```

## uart/Kconfig
```kconfig
# Copyright 2024 NXP
# SPDX-License-Identifier: BSD-3-Clause

config MCUX_COMPONENT_component.iuart_adapter
    bool "Use iuart adapter"
    select MCUX_COMPONENT_driver.iuart
    depends on MCUX_HAS_COMPONENT_driver.iuart
    if MCUX_COMPONENT_component.iuart_adapter
        # config DRIVER_IUART_ADAPTER_CONFIG_DEMO1
        #     bool "Driver IUART_ADAPTER config demo 1"

        # config DRIVER_IUART_ADAPTER_CONFIG_DEMO2
        #     bool "Driver IUART_ADAPTER config demo 2"
    endif


config MCUX_COMPONENT_component.lpsci_adapter
    bool "Use lpsci adapter"
    select MCUX_COMPONENT_driver.lpsci
    depends on MCUX_HAS_COMPONENT_driver.lpsci
    if MCUX_COMPONENT_component.lpsci_adapter
        # config DRIVER_lpsci_ADAPTER_CONFIG_DEMO1
        #     bool "Driver lpsci_ADAPTER config demo 1"

        # config DRIVER_lpsci_ADAPTER_CONFIG_DEMO2
        #     bool "Driver lpsci_ADAPTER config demo 2"
    endif


config MCUX_COMPONENT_component.lpuart_adapter
    bool "Use lpuart adapter"
    select MCUX_COMPONENT_driver.lpuart if MCUX_HAS_COMPONENT_driver.lpuart
    select MCUX_COMPONENT_driver.lpflexcomm_lpuart if MCUX_HAS_COMPONENT_driver.lpflexcomm_lpuart
    depends on MCUX_HAS_COMPONENT_driver.lpuart || MCUX_HAS_COMPONENT_driver.lpflexcomm_lpuart
    if MCUX_COMPONENT_component.lpuart_adapter
        # config DRIVER_lpuart_ADAPTER_CONFIG_DEMO1
        #     bool "Driver lpuart_ADAPTER config demo 1"

        # config DRIVER_lpuart_ADAPTER_CONFIG_DEMO2
        #     bool "Driver lpuart_ADAPTER config demo 2"
    endif


config MCUX_COMPONENT_component.lpuart_dma_adapter
    bool "Use lpuart_dma adapter"
    select MCUX_COMPONENT_component.lpuart_adapter
    select MCUX_COMPONENT_component.timer_manager
    depends on MCUX_HAS_COMPONENT_driver.lpuart
    if MCUX_COMPONENT_component.lpuart_dma_adapter
        # config DRIVER_lpuart_dma_ADAPTER_CONFIG_DEMO1
        #     bool "Driver lpuart_dma_ADAPTER config demo 1"

        # config DRIVER_lpuart_dma_ADAPTER_CONFIG_DEMO2
        #     bool "Driver lpuart_dma_ADAPTER config demo 2"

        choice
            prompt "component.lpuart_dma_adapter anyof dependency"
            default DEPENDENCY_COMPONENT_lpuart_dma_adapter_DEPEND_driver.edma
            config DEPENDENCY_COMPONENT_lpuart_dma_adapter_DEPEND_driver.edma
                bool "driver.lpuart_edma"
                select MCUX_COMPONENT_driver.edma
            config DEPENDENCY_COMPONENT_lpuart_dma_adapter_DEPEND_driver.dma
                bool "driver.lpuart_dma"    
                select MCUX_COMPONENT_driver.dma
        endchoice                
    endif



config MCUX_COMPONENT_component.miniusart_adapter
    bool "Use miniusart adapter"
    select MCUX_COMPONENT_driver.lpc_miniusart
    depends on MCUX_HAS_COMPONENT_driver.lpc_miniusart
    if MCUX_COMPONENT_component.miniusart_adapter
        # config DRIVER_miniusart_ADAPTER_CONFIG_DEMO1
        #     bool "Driver miniusart_ADAPTER config demo 1"

        # config DRIVER_miniusart_ADAPTER_CONFIG_DEMO2
        #     bool "Driver miniusart_ADAPTER config demo 2"
    endif



config MCUX_COMPONENT_component.uart_adapter
    bool "Use uart adapter"
    select MCUX_COMPONENT_driver.uart
    depends on MCUX_HAS_COMPONENT_driver.uart
    if MCUX_COMPONENT_component.uart_adapter
        # config DRIVER_uart_ADAPTER_CONFIG_DEMO1
        #     bool "Driver uart_ADAPTER config demo 1"

        # config DRIVER_uart_ADAPTER_CONFIG_DEMO2
        #     bool "Driver uart_ADAPTER config demo 2"
    endif


config MCUX_COMPONENT_component.usart_adapter
    bool "Use usart adapter"
    select MCUX_COMPONENT_driver.flexcomm_usart
    select MCUX_COMPONENT_driver.flexcomm
    depends on MCUX_HAS_COMPONENT_driver.flexcomm_usart
    if MCUX_COMPONENT_usart_adapter
        # config DRIVER_usart_ADAPTER_CONFIG_DEMO1
        #     bool "Driver usart_ADAPTER config demo 1"

        # config DRIVER_usart_ADAPTER_CONFIG_DEMO2
        #     bool "Driver usart_ADAPTER config demo 2"
    endif


config MCUX_COMPONENT_component.usart_dma_adapter
    bool "Use usart_dma adapter"
    select MCUX_COMPONENT_component.usart_adapter
    select MCUX_COMPONENT_component.timer_manager
    select MCUX_COMPONENT_driver.flexcomm_usart_dma
    depends on MCUX_HAS_COMPONENT_driver.usart
    if MCUX_COMPONENT_component.usart_dma_adapter
        # config DRIVER_usart_dma_ADAPTER_CONFIG_DEMO1
        #     bool "Driver usart_dma_ADAPTER config demo 1"

        # config DRIVER_usart_dma_ADAPTER_CONFIG_DEMO2
        #     bool "Driver usart_dma_ADAPTER config demo 2"              
    endif


config MCUX_COMPONENT_component.vusart_adapter
    bool "Use vusart adapter"
    select MCUX_COMPONENT_driver.vusart
    depends on MCUX_HAS_COMPONENT_driver.vusart
    if MCUX_COMPONENT_component.vusart_adapter
        # config DRIVER_vusart_ADAPTER_CONFIG_DEMO1
        #     bool "Driver vusart_ADAPTER config demo 1"

        # config DRIVER_vusart_ADAPTER_CONFIG_DEMO2
        #     bool "Driver vusart_ADAPTER config demo 2"
    endif



config MCUX_COMPONENT_component.qsci_adapter
    bool "Use qsci adapter"
    select MCUX_COMPONENT_driver.qsci
    depends on MCUX_HAS_COMPONENT_driver.qsci
    if MCUX_COMPONENT_component.qsci_adapter
        # config DRIVER_qsci_ADAPTER_CONFIG_DEMO1
        #     bool "Driver qsci_ADAPTER config demo 1"

        # config DRIVER_qsci_ADAPTER_CONFIG_DEMO2
        #     bool "Driver qsci_ADAPTER config demo 2"
    endif
```
