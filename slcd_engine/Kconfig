## srtm/services/Kconfig
```kconfig
# Copyright 2024-2025 NXP
# SPDX-License-Identifier: BSD-3-Clause

config MCUX_COMPONENT_component.srtm_i2c_service
    bool "I2C"

menuconfig MCUX_COMPONENT_component.srtm_audio_service
    bool "Audio"

if MCUX_COMPONENT_component.srtm_audio_service
    config MCUX_COMPONENT_component.srtm_i2c_codec_adapter
        bool "I2C Codec"
        imply MCUX_COMPONENT_component.codec_i2c

    config MCUX_COMPONENT_component.srtm_pdm_edma_adapter
        bool "pdm edma"
        imply MCUX_COMPONENT_driver.pdm_edma

    config MCUX_COMPONENT_component.srtm_pdm_sdma_adapter
        bool "pdm sdma"
        imply MCUX_COMPONENT_driver.pdm_sdma

    config MCUX_COMPONENT_component.srtm_sai_edma_adapter
        bool "sai edma"
        imply MCUX_COMPONENT_driver.sai_edma

    config MCUX_COMPONENT_component.srtm_sai_sdma_adapter
        bool "sai sdma"
        imply MCUX_COMPONENT_driver.sai_sdma

    config MCUX_COMPONENT_component.srtm_wm8524_adapter
        bool "wm8524"
        imply MCUX_COMPONENT_component.wm8524_adapter
endif

config MCUX_COMPONENT_component.srtm_auto_service
    bool "Auto"

config MCUX_COMPONENT_component.srtm_io_service
    bool "IO"

config MCUX_COMPONENT_component.srtm_keypad_service
    bool "Keypad"

config MCUX_COMPONENT_component.srtm_lfcl_service
    bool "Lifecycle"

config MCUX_COMPONENT_component.srtm_netc_service
    bool "Netc"

config MCUX_COMPONENT_component.srtm_pmic_service
    bool "Pmic"

if MCUX_COMPONENT_component.srtm_pmic_service
    config MCUX_COMPONENT_component.srtm_pf1550_adapter
        bool "Pf1550"
        imply MCUX_COMPONENT_driver.pf1550
endif

menuconfig MCUX_COMPONENT_component.srtm_pwm_service
    bool "pwm"
    imply MCUX_COMPONENT_component.srtm_pwm_adapter

if MCUX_COMPONENT_component.srtm_pwm_service
    config MCUX_COMPONENT_component.srtm_pwm_adapter
        bool "SRTM PWM adapter"

    choice
        prompt "pwm adapters"
        default MCUX_DEPENDENCY_COMPONENT_pwm_adapter_DEPEND_COMPONENT_pwm_tpm_adapter
        config MCUX_DEPENDENCY_COMPONENT_pwm_adapter_DEPEND_COMPONENT_pwm_tpm_adapter
            bool "tpm"
            select MCUX_COMPONENT_component.pwm_tpm_adapter
        config MCUX_DEPENDENCY_COMPONENT_pwm_adapter_DEPEND_COMPONENT_pwm_ftm_adapter
            bool "ftm"
            select MCUX_COMPONENT_component.pwm_ftm_adapter
        config MCUX_DEPENDENCY_COMPONENT_pwm_adapter_DEPEND_COMPONENT_pwm_ctimer_adapter
            bool "ctimer"
            select MCUX_COMPONENT_component.pwm_ctimer_adapter
    endchoice
endif

config MCUX_COMPONENT_component.srtm_snvs_lp_rtc_adapter
    bool "SRTM Snvs Lp Rtc adapter"

config MCUX_COMPONENT_component.srtm_rtc_adapter
    bool "SRTM RTC adapter"

menuconfig MCUX_COMPONENT_component.srtm_rtc_service
    bool "SRTM RTC service"

if MCUX_COMPONENT_component.srtm_rtc_service
    choice
        prompt "Select one of SRTM RTC adapters"
        default MCUX_DEPENDENCY_COMPONENT_srtm_rtc_adapter_DEPEND_COMPONENT_srtm_rtc_adapter
        config MCUX_DEPENDENCY_COMPONENT_srtm_rtc_adapter_DEPEND_COMPONENT_srtm_rtc_adapter
            bool "Select SRTM RTC adapter"
            select MCUX_COMPONENT_component.srtm_rtc_adapter
        config MCUX_DEPENDENCY_COMPONENT_srtm_rtc_adapter_DEPEND_COMPONENT_srtm_snvs_lp_rtc_adapter
            bool "Select SRTM SNVS LP RTC adapter"
            select MCUX_COMPONENT_component.srtm_snvs_lp_rtc_adapter
    endchoice
endif

menuconfig MCUX_COMPONENT_component.srtm_rtc_adapter
    bool "SRTM rtc adapter"

if MCUX_COMPONENT_component.srtm_rtc_adapter
    choice
        prompt "Select one of rtc adapters"
        default MCUX_DEPENDENCY_COMPONENT_rtc_adapter_DEPEND_COMPONENT_rtc_bbnsm_adapter
        config MCUX_DEPENDENCY_COMPONENT_rtc_adapter_DEPEND_COMPONENT_rtc_bbnsm_adapter
            bool "bbnsm"
            select MCUX_COMPONENT_component.rtc_bbnsm_adapter
        config MCUX_DEPENDENCY_COMPONENT_rtc_adapter_DEPEND_COMPONENT_lpcrtc_adapter
            bool "lpcrtc"
            select MCUX_COMPONENT_component.rtc_lpcrtc_adapter
        config MCUX_DEPENDENCY_COMPONENT_rtc_adapter_DEPEND_COMPONENT_rtc_adapter
            bool "rtc"
            select MCUX_COMPONENT_component.rtc_adapter
    endchoice
endif

menuconfig MCUX_COMPONENT_component.srtm_sensor_service
    bool "Sensor"
```

## storage/stream/Kconfig
```kconfig
#
# Copyright (c) 2020 Nordic Semiconductor ASA
# Copyright 2025 NXP
#
# SPDX-License-Identifier: BSD-3-Clause
#

config MCUX_COMPONENT_component.storage_stream
	bool
	select MCUX_COMPONENT_component.zephyr_headers.storage_stream_flash

menuconfig STREAM_FLASH
	bool "Stream to flash"
	select FLASH_PAGE_LAYOUT
	select MCUX_COMPONENT_component.storage_stream
	help
	  Enable support of stream to flash API



if STREAM_FLASH

config STREAM_FLASH_ERASE
	bool "Perform erase operations"
	depends on FLASH_HAS_EXPLICIT_ERASE
	help
	  If disabled an external actor must erase the flash area being written
	  to.

config STREAM_FLASH_PROGRESS
	bool "Persistent stream write progress"
	depends on SETTINGS
	depends on !SETTINGS_NONE
	help
	  Enable API for loading and storing the current write progress to flash
	  using the settings subsystem. In case of power failure or device
	  reset, the API can be used to resume writing from the latest state.

module = STREAM_FLASH
module-str = stream flash
# source "subsys/logging/Kconfig.template.log_config"

endif # STREAM_FLASH
```

## str/Kconfig
```kconfig
# Copyright 2024 NXP
# SPDX-License-Identifier: BSD-3-Clause

config MCUX_COMPONENT_utility.str
    bool "Use utility.str"
    select MCUX_COMPONENT_driver.common
    
    if MCUX_COMPONENT_utility.str

    endif
```

## sx1502/Kconfig
```kconfig
# Copyright 2024 NXP
# SPDX-License-Identifier: BSD-3-Clause

config MCUX_COMPONENT_driver.sx1502
    bool "Component driver.sx1502"
    select MCUX_COMPONENT_component.i2c_adapter_interface
```

## systick_timer/Kconfig
```kconfig
# Copyright 2024 NXP
# SPDX-License-Identifier: BSD-3-Clause

config MCUX_COMPONENT_component.systick_timer
    bool "systick_timer"
```

## time_stamp/Kconfig
```kconfig
# Copyright 2024 NXP
# SPDX-License-Identifier: BSD-3-Clause

config MCUX_COMPONENT_component.pit_time_stamp_adapter
    bool "pit_time_stamp"
    default n
    help
        Enable component.pit_time_stamp_adapter component
    select MCUX_COMPONENT_driver.pit
    depends on MCUX_HAS_COMPONENT_driver.pit


config MCUX_COMPONENT_component.lpit_time_stamp_adapter
    bool "lpit_time_stamp"
    default n
    help
        Enable component.lpit_time_stamp_adapter component
    select MCUX_COMPONENT_driver.lpit
    depends on MCUX_HAS_COMPONENT_driver.lpit


config MCUX_COMPONENT_component.lptmr_time_stamp_adapter
    bool "lptmr_time_stamp"
    default n
    help
        Enable component.lptmr_time_stamp_adapter component
    select MCUX_COMPONENT_driver.lptmr
    depends on MCUX_HAS_COMPONENT_driver.lptmr


config MCUX_COMPONENT_component.ctimer_time_stamp_adapter
    bool "ctimer_time_stamp"
    default n
    help
        Enable component.ctimer_time_stamp_adapter component
    select MCUX_COMPONENT_driver.ctimer
    depends on MCUX_HAS_COMPONENT_driver.ctimer


config MCUX_COMPONENT_component.ostimer_time_stamp_adapter
    bool "ostimer_time_stamp"
    default n
    help
        Enable component.ostimer_time_stamp_adapter component
    select MCUX_COMPONENT_driver.ostimer
    depends on MCUX_HAS_COMPONENT_driver.ostimer


config MCUX_COMPONENT_component.gpt_time_stamp_adapter
    bool "gpt_time_stamp"
    default n
    help
        Enable component.gpt_time_stamp_adapter component
    select MCUX_COMPONENT_driver.gpt
    depends on MCUX_HAS_COMPONENT_driver.gpt
```

## timer/Kconfig
```kconfig
# Copyright 2024 NXP
# SPDX-License-Identifier: BSD-3-Clause

config MCUX_COMPONENT_component.ctimer_adapter
    bool "Enable component.ctimer_adapter"
    default n
    help
        Enable component.ctimer_adapter component
    select MCUX_COMPONENT_driver.ctimer
	depends on MCUX_HAS_COMPONENT_driver.ctimer
    
    
config MCUX_COMPONENT_component.ftm_adapter
    bool "Enable component.ftm_adapter"
    default n
    help
        Enable component.ftm_adapter component
    select MCUX_COMPONENT_driver.ftm
    depends on MCUX_HAS_COMPONENT_driver.ftm
    
    
config MCUX_COMPONENT_component.gpt_adapter
    bool "Enable component.gpt_adapter"
    default n
    help
        Enable component.gpt_adapter component
    select MCUX_COMPONENT_driver.gpt
    depends on MCUX_HAS_COMPONENT_driver.gpt
    
    
config MCUX_COMPONENT_component.lpit_adapter
    bool "Enable component.lpit_adapter"
    default n
    help
        Enable component.lpit_adapter component
    select MCUX_COMPONENT_driver.lpit
    depends on MCUX_HAS_COMPONENT_driver.lpit
    
    
config MCUX_COMPONENT_component.lptmr_adapter
    bool "Enable component.lptmr_adapter"
    default n
    help
        Enable component.lptmr_adapter component
    select MCUX_COMPONENT_driver.lptmr
    depends on MCUX_HAS_COMPONENT_driver.lptmr
    
    
config MCUX_COMPONENT_component.mrt_adapter
    bool "Enable component.mrt_adapter"
    default n
    help
        Enable component.mrt_adapter component
    select MCUX_COMPONENT_driver.mrt
    depends on MCUX_HAS_COMPONENT_driver.mrt
    
    
config MCUX_COMPONENT_component.pit_adapter
    bool "Enable component.pit_adapter"
    default n
    help
        Enable component.pit_adapter component
    select MCUX_COMPONENT_driver.pit
    depends on MCUX_HAS_COMPONENT_driver.pit
    
    
config MCUX_COMPONENT_component.tpm_adapter
    bool "Enable component.tpm_adapter"
    default n
    help
        Enable component.tpm_adapter component
    select MCUX_COMPONENT_driver.tpm
    depends on MCUX_HAS_COMPONENT_driver.tpm
    
    
config MCUX_COMPONENT_component.dsc_pit_adapter
    bool "Enable component.dsc_pit_adapter"
    default n
    help
        Enable component.dsc_pit_adapter component
    select MCUX_COMPONENT_driver.dsc_pit
    depends on MCUX_HAS_COMPONENT_driver.dsc_pit
    
    
config MCUX_COMPONENT_component.ostimer_adapter
    bool "Enable component.ostimer_adapter"
    default n
    help
        Enable component.ostimer_adapter component
    select MCUX_COMPONENT_driver.ostimer
    depends on MCUX_HAS_COMPONENT_driver.ostimer
 
```

## timer_lptmr/Kconfig
```kconfig
# Copyright 2024 NXP
# SPDX-License-Identifier: BSD-3-Clause

config MCUX_COMPONENT_driver.timer_lptmr
    bool "timer_lptmr"
    select MCUX_COMPONENT_driver.lptmr
```
