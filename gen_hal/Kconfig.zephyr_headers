## gen_hal/Kconfig.zephyr_headers
```kconfig
config MCUX_COMPONENT_component.zephyr_headers.toolchain
    bool


config MCUX_COMPONENT_component.zephyr_headers.linkers
    bool

config MCUX_COMPONENT_component.zephyr_headers.types
    bool

config MCUX_COMPONENT_component.zephyr_headers.assert
    bool
    select MCUX_COMPONENT_component.zephyr_headers.toolchain

config MCUX_COMPONENT_component.zephyr_headers.sys_until
    bool
    select MCUX_COMPONENT_component.zephyr_headers.assert
    select MCUX_COMPONENT_component.zephyr_headers.types

config MCUX_COMPONENT_component.zephyr_headers.sys_byteorder
    bool
    select MCUX_COMPONENT_component.zephyr_headers.assert
    select MCUX_COMPONENT_component.zephyr_headers.types

config MCUX_COMPONENT_component.zephyr_headers.arch
    bool
    select MCUX_COMPONENT_component.zephyr_headers.toolchain
    select MCUX_COMPONENT_component.zephyr_headers.types
    select MCUX_COMPONENT_component.zephyr_headers.sys_until

config MCUX_COMPONENT_component.zephyr_headers.atomic
    bool
    select MCUX_COMPONENT_component.zephyr_headers.sys_until
    select MCUX_COMPONENT_component.zephyr_headers.toolchain
    select MCUX_COMPONENT_component.zephyr_headers.types

config MCUX_COMPONENT_component.zephyr_headers.logging
    bool
    select MCUX_COMPONENT_component.zephyr_headers.atomic
    select MCUX_COMPONENT_component.zephyr_headers.assert
    select MCUX_COMPONENT_component.zephyr_headers.toolchain
    select MCUX_COMPONENT_component.zephyr_headers.sys_until

config MCUX_COMPONENT_component.zephyr_headers.kernel
    bool "zephyr header kernel files"
    select MCUX_COMPONENT_component.zephyr_headers.arch
    select MCUX_COMPONENT_component.zephyr_headers.toolchain
    select MCUX_COMPONENT_component.zephyr_headers.types
    select MCUX_COMPONENT_component.zephyr_headers.assert
    select MCUX_COMPONENT_component.zephyr_headers.sys_until
    select MCUX_COMPONENT_component.zephyr_headers.linkers
    select MCUX_COMPONENT_component.zephyr_headers.atomic

config MCUX_COMPONENT_component.zephyr_headers.device
    bool
    select MCUX_COMPONENT_component.zephyr_headers.sys_until
    select MCUX_COMPONENT_component.zephyr_headers.linkers
    select MCUX_COMPONENT_component.zephyr_headers.logging

config MCUX_COMPONENT_component.zephyr_headers.debug_coredump
    bool
    select MCUX_COMPONENT_component.zephyr_headers.sys_byteorder
    select MCUX_COMPONENT_component.zephyr_headers.arch

config MCUX_COMPONENT_component.zephyr_headers.storage_flash_map
    bool
    select MCUX_COMPONENT_component.zephyr_headers.types
    select MCUX_COMPONENT_component.zephyr_headers.device

config MCUX_COMPONENT_component.zephyr_headers.storage_stream_flash
    bool
```

## gen_hal/_boards/frdmrw612/Kconfig
```kconfig
config DT_HAS_NXP_IMX_FLEXSPI_ENABLED
    bool
    default y
config DT_HAS_NXP_LPC_SYSCON_ENABLED
    bool
    default y
config DT_HAS_NXP_MCI_IO_MUX_ENABLED
    bool
    default y
config DT_HAS_NXP_IMX_FLEXSPI_NOR_ENABLED
    bool
    default y

select CLOCK_CONTROL
```

## gen_hal/_boards/frdmrw612/Kconfig.dts_okay
```kconfig
# Generated devicetree Kconfig
#
# SPDX-License-Identifier: Apache-2.0

config DT_HAS_ARM_V8M_NVIC_ENABLED
    bool
    default y

config DT_HAS_NXP_IMX_FLEXSPI_ENABLED
    bool
    default y

config DT_HAS_NXP_IMX_FLEXSPI_NOR_ENABLED
    bool
    default y

config DT_HAS_NXP_LPC_SYSCON_ENABLED
    bool
    default y

config DT_HAS_NXP_MCI_IO_MUX_ENABLED
    bool
    default y

config DT_HAS_NXP_RW_SOC_CTRL_ENABLED
    bool
    default y
```

## gen_hal/clock_control/Kconfig
```kconfig
config MCUX_COMPONENT_component.gen_hal.clock_control
	bool "Memory controller drivers [EXPERIMENTAL]"
	default n
	select MCUX_COMPONENT_component.gen_hal.pinctrl
	select MCUX_COMPONENT_component.zephyr_header.drv_clock_control


config MCUX_COMPONENT_component.gen_hal.clock_control.mcux_syscon
	bool
	default y if DT_HAS_NXP_LPC_SYSCON_ENABLED && MCUX_COMPONENT_component.gen_hal.clock_control


menuconfig CLOCK_CONTROL
	bool 
	default y if MCUX_COMPONENT_component.gen_hal.clock_control
	help
	  Enable support for hardware clock controller. Such hardware can
	  provide clock for other subsystem, and thus can be also used for
	  power efficiency by controlling their clock. Note that this has
	  nothing to do with RTC.

if CLOCK_CONTROL

config CLOCK_CONTROL_INIT_PRIORITY
	int "Clock control init priority"
	default 50
	help
	  Clock control driver device initialization priority.

module = CLOCK_CONTROL
module-str = clock control

rsource "Kconfig.mcux_syscon"

endif  # CLOCK_CONTROL
```

## gen_hal/devices/Wireless/RW/Kconfig
```kconfig
# Copyright 2025 NXP
# SPDX-License-Identifier: Apache-2.0

config SOC_SERIES_RW6XX
	bool
    default y if (MCUX_HW_DEVICE_ID_RW612 || MCUX_HW_DEVICE_ID_RW610)
```

## gen_hal/memc/Kconfig
```kconfig
config MCUX_COMPONENT_component.gen_hal.memc
	bool "Memory controller drivers [EXPERIMENTAL]"
	default n
	select MCUX_COMPONENT_component.gen_hal.pinctrl
	select MCUX_COMPONENT_component.zephyr_header.drv_memc



config MCUX_COMPONENT_component.gen_hal.memc.flexspi
	bool
	default y if MCUX_COMPONENT_component.gen_hal.memc












menuconfig MEMC
	bool
	select EXPERIMENTAL
	default y if MCUX_COMPONENT_component.gen_hal.memc
	help
	  Add support for memory controllers


if MEMC

config MEMC_INIT_PRIORITY
	int "Initialization priority"
	default 0
	help
	  Memory controllers initialization priority.

rsource "Kconfig.mcux"

endif
```

## gen_hal/zephyr/drivers/clock_control/Kconfig
```kconfig
config MCUX_COMPONENT_component.gen_hal.clock_control
	bool

config MCUX_COMPONENT_component.gen_hal.clock_control.mcux_syscon
	bool
	depends on DT_HAS_NXP_LPC_SYSCON_ENABLED

menuconfig CLOCK_CONTROL
	bool "Memory controller drivers [EXPERIMENTAL]"
	select MCUX_COMPONENT_component.gen_hal.clock_control
	help
	  Enable support for hardware clock controller. Such hardware can
	  provide clock for other subsystem, and thus can be also used for
	  power efficiency by controlling their clock. Note that this has
	  nothing to do with RTC.

if CLOCK_CONTROL

config CLOCK_CONTROL_INIT_PRIORITY
	int "Clock control init priority"
	default 50
	help
	  Clock control driver device initialization priority.

module = CLOCK_CONTROL
module-str = clock control

rsource "Kconfig.mcux_syscon"

endif  # CLOCK_CONTROL
```

## gen_hal/zephyr/drivers/clock_control/Kconfig.gen_hal
```kconfig
# Copyright 2025 NXP
#
# SPDX-License-Identifier: BSD-3-Clause

config MCUX_COMPONENT_component.gen_hal.clock_control
	bool

config MCUX_COMPONENT_component.gen_hal.clock_control.mcux_syscon
	bool
	default y if (DT_HAS_NXP_LPC_SYSCON_ENABLED &&  MCUX_COMPONENT_component.gen_hal.clock_control)
```

## gen_hal/zephyr/drivers/flash/Kconfig.gen_hal
```kconfig
# Copyright 2025 NXP
#
# SPDX-License-Identifier: BSD-3-Clause

config MCUX_COMPONENT_component.gen_hal.flash
	bool

config MCUX_COMPONENT_component.gen_hal.flash_flexspi_nor
	bool
	select MCUX_COMPONENT_driver.flexspi
	default y if (DT_HAS_NXP_IMX_FLEXSPI_ENABLED && MCUX_COMPONENT_component.gen_hal.flash)
```

## gen_hal/zephyr/drivers/memc/Kconfig
```kconfig
# Memory controller configuration options

# Copyright (c) 2020 Teslabs Engineering S.L.
# Copyright 2025 NXP
# SPDX-License-Identifier: Apache-2.0

rsource "Kconfig.gen_hal"

menuconfig MEMC
	bool "Memory controller drivers [EXPERIMENTAL]"
	select EXPERIMENTAL
	select MCUX_COMPONENT_component.gen_hal.memc
	help
	  Add support for memory controllers

if MEMC

config MEMC_INIT_PRIORITY
	int "Initialization priority"
	default 80 if MSPI
	default 0
	help
	  Memory controllers initialization priority.

rsource "Kconfig.mcux"

module = MEMC
module-str = memc
endif
```

## gen_hal/zephyr/drivers/memc/Kconfig.gen_hal
```kconfig
# Copyright 2025 NXP
#
# SPDX-License-Identifier: BSD-3-Clause

config MCUX_COMPONENT_component.gen_hal.memc
	bool

config MCUX_COMPONENT_component.gen_hal.memc.flexspi
	bool
	select MCUX_COMPONENT_driver.flexspi
	default y if (DT_HAS_NXP_IMX_FLEXSPI_ENABLED && MCUX_COMPONENT_component.gen_hal.memc)
```

## gen_hal/zephyr/drivers/pinctrl/Kconfig.gen_hal
```kconfig
# Copyright 2025 NXP
#
# SPDX-License-Identifier: BSD-3-Clause

config MCUX_COMPONENT_component.gen_hal.pinctrl
	bool

config MCUX_COMPONENT_component.gen_hal.pinctrl.mci_io_mux
	bool
	select MCUX_COMPONENT_driver.io_mux
	default y if (DT_HAS_NXP_MCI_IO_MUX_ENABLED && MCUX_COMPONENT_component.gen_hal.pinctrl)
```

## gen_hal/zephyr/drivers/pinctrl/Kconfig.mci_io_mux
```kconfig
# Copyright 2022 NXP
# SPDX-License-Identifier: Apache-2.0

config PINCTRL_MCI_IO_MUX
	bool "NXP MCI IO MUX Pinctrl Driver"
	default y
	depends on DT_HAS_NXP_MCI_IO_MUX_ENABLED
	select MCUX_COMPONENT_component.gen_hal.pinctrl.mci_io_mux
	help
	  Enable pin controller driver for NXP MCI_IO_MUX
```

## i2c/muxes/Kconfig
```kconfig
menu "Multiplexer I2C Chip support"

config MCUX_COMPONENT_component.i2c_mux
        bool "i2c mux component"

config MCUX_COMPONENT_component.i2c_mux_pca954x
        bool "NXP PCA954x/PCA984x and Maxim MAX735x/MAX736x I2C Mux/switches"
	help
        depends on MCUX_COMPONENT_component.i2c_mux
	  If you say yes here you get support for NXP PCA954x/PCA984x
          and Maxim MAX735x/MAX736x I2C mux/switch devices.
if MCUX_COMPONENT_component.i2c_mux_pca954x
        config MCUX_COMPONENT_component.enable_max7356
            bool "Enable MAX7356"
            help
                Enable MAX7356
        config MCUX_COMPONENT_component.enable_max7357
            bool "Enable MAX7357"
            help
                Enable MAX7357
        config MCUX_COMPONENT_component.enable_max7358
            bool "Enable MAX7358"
            help
                Enable MAX7358
        config MCUX_COMPONENT_component.enable_max7367
            bool "Enable MAX7367"
            help
                Enable MAX7367
        config MCUX_COMPONENT_component.enable_max7368
            bool "Enable MAX7368"
            help
                Enable MAX7368
        config MCUX_COMPONENT_component.enable_max7369
            bool "Enable MAX7369"
            help
                Enable MAX7369
        config MCUX_COMPONENT_component.enable_pca9540
            bool "Enable PCA9540"
            help
                Enable PCA9540
        config MCUX_COMPONENT_component.enable_pca9542
            bool "Enable PCA9542"
            help
                Enable PCA9542
        config MCUX_COMPONENT_component.enable_pca9543
            bool "Enable PCA9543"
            help
                Enable PCA9543
        config MCUX_COMPONENT_component.enable_pca9544
            bool "Enable PCA9544"
            help
                Enable PCA9544
        config MCUX_COMPONENT_component.enable_pca9545
            bool "Enable PCA9545"
            help
                Enable PCA9545
        config MCUX_COMPONENT_component.enable_pca9546
            bool "Enable PCA9546"
            help
                Enable PCA9546
        config MCUX_COMPONENT_component.enable_pca9547
            bool "Enable PCA9547"
            help
                Enable PCA9547
        config MCUX_COMPONENT_component.enable_pca9548
            bool "Enable PCA9548"
            help
                Enable PCA9548
        config MCUX_COMPONENT_component.enable_pca9646
            bool "Enable PCA9646"
            help
                Enable PCA9646
        config MCUX_COMPONENT_component.enable_pca9846
            bool "Enable PCA9846"
            help
                Enable PCA9846
        config MCUX_COMPONENT_component.enable_pca9847
            bool "Enable PCA9847"
            help
                Enable PCA9847
        config MCUX_COMPONENT_component.enable_pca9848
            bool "Enable PCA9848"
            help
                Enable PCA9848
        config MCUX_COMPONENT_component.enable_pca9849
            bool "Enable PCA9849"
            help
                Enable PCA9849
        config MCUX_COMPONENT_component.at_least_one_i2c_mux_device_enabled
            bool
            default y if MCUX_COMPONENT_component.enable_max7356 || \
                         MCUX_COMPONENT_component.enable_max7357 || \
                         MCUX_COMPONENT_component.enable_max7358 || \
                         MCUX_COMPONENT_component.enable_max7367 || \
                         MCUX_COMPONENT_component.enable_max7368 || \
                         MCUX_COMPONENT_component.enable_max7369 || \
                         MCUX_COMPONENT_component.enable_pca9540 || \
                         MCUX_COMPONENT_component.enable_pca9542 || \
                         MCUX_COMPONENT_component.enable_pca9543 || \
                         MCUX_COMPONENT_component.enable_pca9544 || \
                         MCUX_COMPONENT_component.enable_pca9545 || \
                         MCUX_COMPONENT_component.enable_pca9546 || \
                         MCUX_COMPONENT_component.enable_pca9547 || \
                         MCUX_COMPONENT_component.enable_pca9548 || \
                         MCUX_COMPONENT_component.enable_pca9646 || \
                         MCUX_COMPONENT_component.enable_pca9846 || \
                         MCUX_COMPONENT_component.enable_pca9847 || \
                         MCUX_COMPONENT_component.enable_pca9848 || \
                         MCUX_COMPONENT_component.enable_pca9849
                         
        config MCUX_COMPONENT_component.i2c_mux_device_selection_err
            bool
	    depends on !MCUX_COMPONENT_component.at_least_one_i2c_mux_device_enabled
            default y
	    prompt "Error: At least one i2c mux device must be enabled"

endif

endmenu
```

## i3c_bus/Kconfig
```kconfig
# Copyright 2024 NXP
# SPDX-License-Identifier: BSD-3-Clause

config MCUX_COMPONENT_component.i3c_bus
    bool "i3c_bus"
    select MCUX_COMPONENT_component.lists

config MCUX_COMPONENT_component.i3c_bus_adapter
    bool "i3c_bus_adapter"
    select MCUX_COMPONENT_driver.i3c
    select MCUX_COMPONENT_component.i3c_bus
```

## imu_adapter/Kconfig
```kconfig
# Copyright 2024 NXP
# SPDX-License-Identifier: BSD-3-Clause

config MCUX_COMPONENT_component.wireless_imu_adapter
    bool "wireless_imu"
    select MCUX_COMPONENT_driver.gdma
    select MCUX_COMPONENT_driver.imu
    select MCUX_COMPONENT_component.osa
```

## imx_sm_crc/Kconfig
```kconfig
# Copyright 2024 NXP
# SPDX-License-Identifier: BSD-3-Clause

config MCUX_COMPONENT_component.sm.crc
    bool "Enable component.sm.crc"
    default n
    help
	Enable component.sm.crc component
```
