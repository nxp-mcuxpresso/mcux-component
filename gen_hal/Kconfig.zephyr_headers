## internal_flash/Kconfig
```kconfig
# Copyright 2024-2025 NXP
# SPDX-License-Identifier: BSD-3-Clause

config MCUX_COMPONENT_component.flash_adapter
    bool "Enable component.flash_adapter"
    default n
    help
        Enable component.flash_adapter component
    if MCUX_COMPONENT_component.flash_adapter
        choice
            prompt "component.flash_adapter anyof dependency"
            default MCUX_DEPENDENCY_COMPONENT_component.flash_adapter_anyof_allof1
            config MCUX_DEPENDENCY_COMPONENT_component.flash_adapter_anyof_allof1
                bool "Select driver.flash and component.Legacy_flash_adapter"
                select MCUX_COMPONENT_component.Legacy_flash_adapter   
                depends on MCUX_HAS_COMPONENT_driver.flash
            config MCUX_DEPENDENCY_COMPONENT_component.flash_adapter_anyof_allof2
                bool "Select driver.flash and component.JNflash_adapter"
                select MCUX_COMPONENT_component.JNflash_adapter   
                depends on MCUX_HAS_COMPONENT_driver.JNflash
            config MCUX_DEPENDENCY_COMPONENT_component.flash_adapter_anyof_allof3
                bool "Select driver.k4_flash and component.k4_flash_adapter"
                select MCUX_COMPONENT_component.k4_flash_adapter
                depends on MCUX_HAS_COMPONENT_driver.flash_k4
            config MCUX_DEPENDENCY_COMPONENT_component.flash_adapter_anyof_allof4
                bool "Select driver.flashiap and component.flashiap_adapter"
                select MCUX_COMPONENT_component.flashiap_adapter                                                                                                                                 
                depends on MCUX_HAS_COMPONENT_driver.flashiap
            config MCUX_DEPENDENCY_COMPONENT_component.flash_adapter_anyof_allof5
                bool "Select component.flexspi_nor_flash_adapter_evkmimxrt1060"
                select MCUX_COMPONENT_component.flexspi_nor_flash_adapter_rt1060                                                                                                                                 
                depends on MCUX_HW_BOARD_evkmimxrt1060
            config MCUX_DEPENDENCY_COMPONENT_component.flash_adapter_anyof_allof6
                bool "Select component.mcxw_flash_adapter"
                select MCUX_COMPONENT_component.mcxw_flash_adapter                                                                                                                                 
                depends on MCUX_HAS_COMPONENT_driver.romapi
            config MCUX_DEPENDENCY_COMPONENT_component.flash_adapter_anyof_allof7
                bool "Select component.flexspi_nor_flash_adapter_rt1060evkb"
                select MCUX_COMPONENT_component.flexspi_nor_flash_adapter_rt1060evkb                                                                                                                                 
                depends on MCUX_HW_BOARD_evkbmimxrt1060
            config MCUX_DEPENDENCY_COMPONENT_component.flash_adapter_anyof_allof8
                bool "Select component.flexspi_nor_flash_adapter_rt1170"
                select MCUX_COMPONENT_component.flexspi_nor_flash_adapter_rt1170                                                                                                                                 
                depends on MCUX_HW_BOARD_evkmimxrt1170
            config MCUX_DEPENDENCY_COMPONENT_component.flash_adapter_anyof_allof9
                bool "Select component.flexspi_nor_flash_adapter_rt1170evkb"
                select MCUX_COMPONENT_component.flexspi_nor_flash_adapter_rt1170evkb                                                                                                                                 
                depends on MCUX_HW_BOARD_evkbmimxrt1170
            config MCUX_DEPENDENCY_COMPONENT_component.flash_adapter_anyof_allof10
                bool "Select component.flexspi_nor_flash_adapter_rt685evk"
                select MCUX_COMPONENT_component.flexspi_nor_flash_adapter_rt685evk                                                                                                                                 
                depends on MCUX_HW_BOARD_evkmimxrt685
            config MCUX_DEPENDENCY_COMPONENT_component.flash_adapter_anyof_allof11
                bool "Select component.flexspi_nor_flash_adapter_rt595evk"
                select MCUX_COMPONENT_component.flexspi_nor_flash_adapter_rt595evk                                                                                                                                 
                depends on MCUX_HW_BOARD_evkmimxrt595		
            config MCUX_DEPENDENCY_COMPONENT_component.flash_adapter_anyof_allof12
                bool "Select component.flexspi_nor_flash_adapter_rt1040evk"
                select MCUX_COMPONENT_component.flexspi_nor_flash_adapter_rt1040evk                                                                                                                                 
                depends on MCUX_HW_BOARD_evkmimxrt1040
            config MCUX_DEPENDENCY_COMPONENT_component.flash_adapter_anyof_allof13
                bool "Select component.flexspi_hyper_flash_adapter_rt1050"
                select MCUX_COMPONENT_component.flexspi_hyper_flash_adapter_rt1050                                                                                                                                 
                depends on MCUX_HW_BOARD_evkmimxrt1050
            config MCUX_DEPENDENCY_COMPONENT_component.flash_adapter_anyof_allof14
                bool "Select component.flexspi_nor_flash_adapter_rw61x"
                select MCUX_COMPONENT_component.flexspi_nor_flash_adapter_rw61x                                                                                                                                 
                depends on MCUX_HW_DEVICE_RW610 || MCUX_HW_DEVICE_RW612
            config MCUX_DEPENDENCY_COMPONENT_component.flash_adapter_anyof_allof15
                bool "Select component.flexspi_nor_flash_adapter_rt1020"
                select MCUX_COMPONENT_component.flexspi_nor_flash_adapter_rt1020                                                                                                                                 
                depends on MCUX_HW_BOARD_evkmimxrt1020
            config MCUX_DEPENDENCY_COMPONENT_component.flash_adapter_anyof_allof16
                bool "Select component.flexspi_nor_flash_adapter_rt1160"
                select MCUX_COMPONENT_component.flexspi_nor_flash_adapter_rt1160                                                                                                                                 
                depends on MCUX_HW_BOARD_evkmimxrt1160					
        endchoice        
    endif
    
config MCUX_COMPONENT_component.Legacy_flash_adapter
    bool "Enable component.Legacy_flash_adapter"
    default n
    help
        Enable component.Legacy_flash_adapter component
    select MCUX_COMPONENT_driver.flash
    depends on MCUX_HAS_COMPONENT_driver.flash
    
config MCUX_COMPONENT_component.JNflash_adapter
    bool "Enable component.JNflash_adapter"
    default n
    help
        Enable component.JNflash_adapter component
    select MCUX_COMPONENT_driver.jn_flash
    depends on MCUX_HAS_COMPONENT_driver.JNflash
    
    
config MCUX_COMPONENT_component.flashiap_adapter
    bool "Enable component.flashiap_adapter"
    default n
    help
        Enable component.flashiap_adapter component
    select MCUX_COMPONENT_driver.flashiap
    depends on MCUX_HAS_COMPONENT_driver.flashiap
    
config MCUX_COMPONENT_component.k4_flash_adapter
    bool "Enable component.k4_flash_adapter"
    default n
    help
        Enable component.k4_flash_adapter component
    select MCUX_COMPONENT_driver.flash_k4
    depends on MCUX_HAS_COMPONENT_driver.flash_k4
    if MCUX_COMPONENT_component.k4_flash_adapter
        choice
            prompt "MCUX_COMPONENT_component.k4_flash_adapter option 4"
            default MCUX_DEPENDENCY_COMPONENT_component.k4_flash_adapter_DEPEND_COMPONENT_OPTION_1
            config MCUX_DEPENDENCY_COMPONENT_component.k4_flash_adapter_DEPEND_COMPONENT_OPTION_1
                bool "Select driver.flash_k4"
                select MCUX_COMPONENT_driver.flash_k4
            config MCUX_DEPENDENCY_COMPONENT_component.k4_flash_adapter_DEPEND_COMPONENT_OPTION_2
                bool "Select driver.romapi"
                select MCUX_COMPONENT_driver.romapi
        endchoice
    endif   
    
config MCUX_COMPONENT_component.flexspi_nor_flash_adapter_rt1060
    bool "Enable component.flexspi_nor_flash_adapter_rt1060"
    default n
    help
        Enable component.flexspi_nor_flash_adapter_rt1060 component
    select MCUX_COMPONENT_driver.flexspi
    depends on MCUX_HW_BOARD_evkmimxrt1060
    
    
config MCUX_COMPONENT_component.mcxw_flash_adapter
    bool "Enable component.mcxw_flash_adapter"
    default n
    help
        Enable component.mcxw_flash_adapter component
    select MCUX_COMPONENT_driver.romapi
    depends on MCUX_HAS_COMPONENT_driver.romapi
    
    
config MCUX_COMPONENT_component.flexspi_nor_flash_adapter_rt1060evkb
    bool "Enable component.flexspi_nor_flash_adapter_rt1060evkb"
    default n
    help
        Enable component.flexspi_nor_flash_adapter_rt1060evkb component
    select MCUX_COMPONENT_driver.flexspi
    depends on MCUX_HW_BOARD_evkbmimxrt1060    
    
config MCUX_COMPONENT_component.flexspi_nor_flash_adapter_rt1170
    bool "Enable component.flexspi_nor_flash_adapter_rt1170"
    default n
    help
        Enable component.flexspi_nor_flash_adapter_rt1170 component
    select MCUX_COMPONENT_driver.flexspi
    depends on MCUX_HW_BOARD_evkmimxrt1170      
    
config MCUX_COMPONENT_component.flexspi_nor_flash_adapter_rt1170evkb
    bool "Enable component.flexspi_nor_flash_adapter_rt1170evkb"
    default n
    help
        Enable component.flexspi_nor_flash_adapter_rt1170evkb component
    select MCUX_COMPONENT_driver.flexspi
    depends on MCUX_HW_BOARD_evkbmimxrt1170     
    
config MCUX_COMPONENT_component.flexspi_nor_flash_adapter_rt685evk
    bool "Enable component.flexspi_nor_flash_adapter_rt685evk"
    default n
    help
        Enable component.flexspi_nor_flash_adapter_rt685evk component
    select MCUX_COMPONENT_driver.flexspi
    depends on MCUX_HW_BOARD_evkmimxrt685
    
config MCUX_COMPONENT_component.flexspi_nor_flash_adapter_rt595evk
    bool "Enable component.flexspi_nor_flash_adapter_rt595evk"
    default n
    help
        Enable component.flexspi_nor_flash_adapter_rt595evk component
    select MCUX_COMPONENT_driver.flexspi
    depends on MCUX_HW_BOARD_evkmimxrt595    
    
config MCUX_COMPONENT_component.flexspi_nor_flash_adapter_rt1040evk
    bool "Enable component.flexspi_nor_flash_adapter_rt1040evk"
    default n
    help
        Enable component.flexspi_nor_flash_adapter_rt1040evk component
    select MCUX_COMPONENT_driver.flexspi
    depends on MCUX_HW_BOARD_evkmimxrt1040    
    
config MCUX_COMPONENT_component.flexspi_hyper_flash_adapter_rt1050
    bool "Enable component.flexspi_hyper_flash_adapter_rt1050"
    default n
    help
        Enable component.flexspi_hyper_flash_adapter_rt1050 component
    select MCUX_COMPONENT_driver.flexspi
    depends on MCUX_HW_BOARD_evkmimxrt1050    
    
config MCUX_COMPONENT_component.flexspi_nor_flash_adapter_rw61x
    bool "Enable component.flexspi_nor_flash_adapter_rw61x"
    default n
    help
        Enable component.flexspi_nor_flash_adapter_rw61x component
    select MCUX_COMPONENT_driver.flexspi
    depends on MCUX_HW_DEVICE_RW610 || MCUX_HW_DEVICE_RW612    
    
config MCUX_COMPONENT_component.flexspi_nor_flash_adapter_rt1020
    bool "Enable component.flexspi_nor_flash_adapter_rt1020"
    default n
    help
        Enable component.flexspi_nor_flash_adapter_rt1020 component
    select MCUX_COMPONENT_driver.flexspi
    depends on MCUX_HW_BOARD_evkmimxrt1020      
    
config MCUX_COMPONENT_component.flexspi_nor_flash_adapter_rt1160
    bool "Enable component.flexspi_nor_flash_adapter_rt1160"
    default n
    help
        Enable component.flexspi_nor_flash_adapter_rt1160 component
    select MCUX_COMPONENT_driver.flexspi
    depends on MCUX_HW_BOARD_evkmimxrt1160
```

## lce/Kconfig
```kconfig
# Copyright 2025 NXP
# SPDX-License-Identifier: BSD-3-Clause

config MCUX_COMPONENT_component.lce
    bool "lce"
    select MCUX_COMPONENT_driver.ce
```

## led/Kconfig
```kconfig
# Copyright 2024 NXP
# SPDX-License-Identifier: BSD-3-Clause

config MCUX_COMPONENT_component.led
    # depends on MCUX_COMPONENT_component.led
    bool "led"
    select MCUX_COMPONENT_driver.common
    select MCUX_COMPONENT_component.timer_manager

    if MCUX_COMPONENT_component.led
        choice
            prompt "component.led anyof dependency"
            default MCUX_DEPENDENCY_COMPONENT_component.led_DEPEND_component.led_gpio_adapter
            config MCUX_DEPENDENCY_COMPONENT_component.led_DEPEND_component.led_gpio_adapter
                bool "gpio"
                select MCUX_COMPONENT_component.gpio_adapter
                depends on MCUX_HAS_COMPONENT_driver.gpio
            config MCUX_DEPENDENCY_COMPONENT_component.led_DEPEND_component.lpc_gpio_adapter
                bool "lpc_gpio"
                select MCUX_COMPONENT_component.lpc_gpio_adapter
                depends on MCUX_HAS_COMPONENT_driver.lpc_gpio
            config MCUX_DEPENDENCY_COMPONENT_component.led_DEPEND_component.igpio_adapter
                bool "igpio"
                select MCUX_COMPONENT_component.igpio_adapter
                depends on MCUX_HAS_COMPONENT_driver.igpio
        endchoice
    endif
```

## log/Kconfig
```kconfig
# Copyright 2024 NXP
# SPDX-License-Identifier: BSD-3-Clause

config MCUX_COMPONENT_component.log
    # depends on MCUX_COMPONENT_component.log
    bool "log"
    select MCUX_COMPONENT_driver.common
    select MCUX_COMPONENT_utility.str

if MCUX_COMPONENT_component.log

endif
config MCUX_COMPONENT_component.log.backend.debug_console
    # depends on MCUX_COMPONENT_component.log.backend.debug_console
    bool "log backend debug_console"
    select MCUX_COMPONENT_driver.common
    select MCUX_COMPONENT_component.log
    select MCUX_COMPONENT_utility.debug_console

if MCUX_COMPONENT_component.log.backend.debug_console

endif

config MCUX_COMPONENT_component.log.backend.debug_console_lite
    # depends on MCUX_COMPONENT_component.log.backend.debug_console_lite
    bool "log backend debug_console_lite"
    select MCUX_COMPONENT_driver.common
    select MCUX_COMPONENT_component.log
    select MCUX_COMPONENT_utility.debug_console_lite

if MCUX_COMPONENT_component.log.backend.debug_console_lite

endif

config MCUX_COMPONENT_component.log.backend.ringbuffer
    # depends on MCUX_COMPONENT_component.log.backend.ringbuffer
    bool "log backend ringbuffer"
    select MCUX_COMPONENT_driver.common
    select MCUX_COMPONENT_component.log

if MCUX_COMPONENT_component.log.backend.ringbuffer

endif
```
