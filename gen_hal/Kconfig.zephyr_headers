## mem_manager/Kconfig
```kconfig
# Copyright 2024 NXP
# SPDX-License-Identifier: BSD-3-Clause

config MCUX_COMPONENT_component.mem_manager
    bool "Enable component.mem_manager"
    default n
    help
        Enable component.mem_manager component
    select MCUX_COMPONENT_component.lists
    if MCUX_COMPONENT_component.mem_manager
        choice MCUX_COMPONENT_component.mem_manager_selection
            prompt "Mem_manager selection"
            default MCUX_COMPONENT_component.mem_manager_freertos if MCUX_COMPONENT_middleware.freertos-kernel
            default MCUX_COMPONENT_component.mem_manager_light
            config MCUX_COMPONENT_component.mem_manager_legacy
                bool "Select component mem_manager_legacy"
            config MCUX_COMPONENT_component.mem_manager_light
                bool "Select component mem_manager_light"
            config MCUX_COMPONENT_component.mem_manager_freertos
                bool "Select component mem_manager_freertos"
                depends on MCUX_COMPONENT_middleware.freertos-kernel
        endchoice
    endif
```

## messaging/Kconfig
```kconfig
# Copyright 2024 NXP
# SPDX-License-Identifier: BSD-3-Clause

config MCUX_COMPONENT_component.messaging
    bool "Enable component.messaging"
    select MCUX_COMPONENT_component.mem_manager
    select MCUX_COMPONENT_component.lists
    help
        Enable component.messaging component
```

## misc_utilities/Kconfig
```kconfig
# Copyright 2024-2025 NXP
# SPDX-License-Identifier: BSD-3-Clause

config MCUX_COMPONENT_utilities.misc_utilities
    bool "misc_utilities"

    if MCUX_COMPONENT_utilities.misc_utilities
    endif

config MCUX_COMPONENT_utility.incbin
    bool "incbin"
    help
         Used to include slave core binary into master core binary.

if MCUX_COMPONENT_utility.incbin
    config UTILITY_INCBIN_NS
        default n
        bool "Include non-secure portions of the slave core binary into master core binary"
endif
```

## mpi_loader/Kconfig
```kconfig
# Copyright 2024 NXP
# SPDX-License-Identifier: BSD-3-Clause

config MCUX_COMPONENT_component.mpi_loader
    bool "Component component.mpi_loader"
    
```
